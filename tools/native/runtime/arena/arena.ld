/* GENERATED by gen_arena.py - M2 globals arena (Mechanic B).
 * ROM base 0x133B80, span 0x14AD80 (1775 placed, 14 unresolved).
 * INSERT fragment: augments the default link script. */
SECTIONS {
  .gamedata (NOLOAD) : ALIGN(16) {
    __gamedata_start = .;
    *(.gamedata)
    . = __gamedata_start + 0x14AD80;
    __gamedata_end = .;
  }
}
INSERT AFTER .bss;

/* ROM base = 0x133B80 */
PROVIDE(D_00133B80 = __gamedata_start + 0x0);
PROVIDE(D_00133E74 = __gamedata_start + 0x2F4);
PROVIDE(D_00133E78 = __gamedata_start + 0x2F8);
PROVIDE(D_001341E0 = __gamedata_start + 0x660);
PROVIDE(D_001341E4 = __gamedata_start + 0x664);
PROVIDE(D_00134640 = __gamedata_start + 0xAC0);
PROVIDE(D_00134668 = __gamedata_start + 0xAE8);
PROVIDE(D_0013466C = __gamedata_start + 0xAEC);
PROVIDE(D_00134670 = __gamedata_start + 0xAF0);
PROVIDE(D_00134674 = __gamedata_start + 0xAF4);
PROVIDE(D_00134684 = __gamedata_start + 0xB04);
PROVIDE(D_00134688 = __gamedata_start + 0xB08);
PROVIDE(D_00134690 = __gamedata_start + 0xB10);
PROVIDE(D_00134694 = __gamedata_start + 0xB14);
PROVIDE(D_00134698 = __gamedata_start + 0xB18);
PROVIDE(D_0013469C = __gamedata_start + 0xB1C);
PROVIDE(D_001346A0 = __gamedata_start + 0xB20);
PROVIDE(D_001346A8 = __gamedata_start + 0xB28);
PROVIDE(D_00134728 = __gamedata_start + 0xBA8);
PROVIDE(D_0013472C = __gamedata_start + 0xBAC);
PROVIDE(D_00134730 = __gamedata_start + 0xBB0);
PROVIDE(D_00134734 = __gamedata_start + 0xBB4);
PROVIDE(D_00134738 = __gamedata_start + 0xBB8);
PROVIDE(D_0013473C = __gamedata_start + 0xBBC);
PROVIDE(D_00134740 = __gamedata_start + 0xBC0);
PROVIDE(D_00134744 = __gamedata_start + 0xBC4);
PROVIDE(D_00134748 = __gamedata_start + 0xBC8);
PROVIDE(D_0013474C = __gamedata_start + 0xBCC);
PROVIDE(D_00134750 = __gamedata_start + 0xBD0);
PROVIDE(D_00134AC8 = __gamedata_start + 0xF48);
PROVIDE(D_00134AD0 = __gamedata_start + 0xF50);
PROVIDE(D_00134DA0 = __gamedata_start + 0x1220);
PROVIDE(D_00134DA8 = __gamedata_start + 0x1228);
PROVIDE(D_00134DB8 = __gamedata_start + 0x1238);
PROVIDE(D_00134DBC = __gamedata_start + 0x123C);
PROVIDE(D_00134DC0 = __gamedata_start + 0x1240);
PROVIDE(D_00135568 = __gamedata_start + 0x19E8);
PROVIDE(D_00135588 = __gamedata_start + 0x1A08);
PROVIDE(D_00135CC8 = __gamedata_start + 0x2148);
PROVIDE(D_00135CF0 = __gamedata_start + 0x2170);
PROVIDE(D_00135D34 = __gamedata_start + 0x21B4);
PROVIDE(D_00135D38 = __gamedata_start + 0x21B8);
PROVIDE(D_00136390 = __gamedata_start + 0x2810);
PROVIDE(D_00136394 = __gamedata_start + 0x2814);
PROVIDE(D_001363A0 = __gamedata_start + 0x2820);
PROVIDE(D_001363A4 = __gamedata_start + 0x2824);
PROVIDE(D_001363A8 = __gamedata_start + 0x2828);
PROVIDE(D_001363AC = __gamedata_start + 0x282C);
PROVIDE(D_001363B0 = __gamedata_start + 0x2830);
PROVIDE(D_001363B4 = __gamedata_start + 0x2834);
PROVIDE(D_001363B8 = __gamedata_start + 0x2838);
PROVIDE(D_001363BC = __gamedata_start + 0x283C);
PROVIDE(D_001363C0 = __gamedata_start + 0x2840);
PROVIDE(D_001363C4 = __gamedata_start + 0x2844);
PROVIDE(D_001363C8 = __gamedata_start + 0x2848);
PROVIDE(D_001363CC = __gamedata_start + 0x284C);
PROVIDE(D_001363D0 = __gamedata_start + 0x2850);
PROVIDE(D_001363D4 = __gamedata_start + 0x2854);
PROVIDE(D_00136400 = __gamedata_start + 0x2880);
PROVIDE(D_00136480 = __gamedata_start + 0x2900);
PROVIDE(D_00137480 = __gamedata_start + 0x3900);
PROVIDE(D_00137540 = __gamedata_start + 0x39C0);
PROVIDE(D_00137550 = __gamedata_start + 0x39D0);
PROVIDE(D_00137580 = __gamedata_start + 0x3A00);
PROVIDE(D_001379C0 = __gamedata_start + 0x3E40);
PROVIDE(D_00137DC8 = __gamedata_start + 0x4248);
PROVIDE(D_00137E00 = __gamedata_start + 0x4280);
PROVIDE(D_00137E30 = __gamedata_start + 0x42B0);
PROVIDE(D_00137E68 = __gamedata_start + 0x42E8);
PROVIDE(g_mcPendingCmd = __gamedata_start + 0x42E8);
PROVIDE(g_mcMutexSema = __gamedata_start + 0x42EC);
PROVIDE(D_00137E80 = __gamedata_start + 0x4300);
PROVIDE(D_00137E88 = __gamedata_start + 0x4308);
PROVIDE(D_00137ED0 = __gamedata_start + 0x4350);
PROVIDE(D_00137EF0 = __gamedata_start + 0x4370);
PROVIDE(D_00137F10 = __gamedata_start + 0x4390);
PROVIDE(D_00137F38 = __gamedata_start + 0x43B8);
PROVIDE(D_00137F78 = __gamedata_start + 0x43F8);
PROVIDE(D_00138040 = __gamedata_start + 0x44C0);
PROVIDE(D_00138080 = __gamedata_start + 0x4500);
PROVIDE(D_001380D0 = __gamedata_start + 0x4550);
PROVIDE(D_00138120 = __gamedata_start + 0x45A0);
PROVIDE(D_00138150 = __gamedata_start + 0x45D0);
PROVIDE(D_00138152 = __gamedata_start + 0x45D2);
PROVIDE(D_00138156 = __gamedata_start + 0x45D6);
PROVIDE(D_00138158 = __gamedata_start + 0x45D8);
PROVIDE(D_138180 = __gamedata_start + 0x4600);
PROVIDE(D_1382C8 = __gamedata_start + 0x4748);
PROVIDE(D_1382CC = __gamedata_start + 0x474C);
PROVIDE(D_138320 = __gamedata_start + 0x47A0);
PROVIDE(D_138324 = __gamedata_start + 0x47A4);
PROVIDE(g_padButtonsHeld = __gamedata_start + 0x47C0);
PROVIDE(g_padButtonsPressed = __gamedata_start + 0x47C4);
PROVIDE(D_13834C = __gamedata_start + 0x47CC);
PROVIDE(D_138358 = __gamedata_start + 0x47D8);
PROVIDE(g_fullScreenTintPacket = __gamedata_start + 0x4CD0);
PROVIDE(g_fadeQuadPacket = __gamedata_start + 0x4E10);
PROVIDE(D_1390B0 = __gamedata_start + 0x5530);
PROVIDE(D_139120 = __gamedata_start + 0x55A0);
PROVIDE(D_1391D0 = __gamedata_start + 0x5650);
PROVIDE(D_139300 = __gamedata_start + 0x5780);
PROVIDE(D_139310 = __gamedata_start + 0x5790);
PROVIDE(D_139370 = __gamedata_start + 0x57F0);
PROVIDE(D_139380 = __gamedata_start + 0x5800);
PROVIDE(D_1393E0 = __gamedata_start + 0x5860);
PROVIDE(g_areaTable = __gamedata_start + 0x5860);
PROVIDE(D_001393E8 = __gamedata_start + 0x5868);
PROVIDE(D_001393F0 = __gamedata_start + 0x5870);
PROVIDE(D_1393F0 = __gamedata_start + 0x5870);
PROVIDE(D_001393F8 = __gamedata_start + 0x5878);
PROVIDE(D_00139410 = __gamedata_start + 0x5890);
PROVIDE(D_00139528 = __gamedata_start + 0x59A8);
PROVIDE(D_0013953C = __gamedata_start + 0x59BC);
PROVIDE(D_00139544 = __gamedata_start + 0x59C4);
PROVIDE(D_00139548 = __gamedata_start + 0x59C8);
PROVIDE(D_0013954C = __gamedata_start + 0x59CC);
PROVIDE(D_00139554 = __gamedata_start + 0x59D4);
PROVIDE(D_0013955C = __gamedata_start + 0x59DC);
PROVIDE(g_exitSceneArmed = __gamedata_start + 0x59DC);
PROVIDE(g_itemEquippedSlot = __gamedata_start + 0x59E8);
PROVIDE(D_0013956E = __gamedata_start + 0x59EE);
PROVIDE(g_quickSelectMap = __gamedata_start + 0x5A07);
PROVIDE(D_1395B8 = __gamedata_start + 0x5A38);
PROVIDE(D_1395C1 = __gamedata_start + 0x5A41);
PROVIDE(D_1395D5 = __gamedata_start + 0x5A55);
PROVIDE(D_1395E9 = __gamedata_start + 0x5A69);
PROVIDE(D_139648 = __gamedata_start + 0x5AC8);
PROVIDE(g_weaponAmmo = __gamedata_start + 0x5B08);
PROVIDE(g_cinematicUnlockedFlags = __gamedata_start + 0x5BE8);
PROVIDE(D_1397C4 = __gamedata_start + 0x5C44);
PROVIDE(D_1397E0 = __gamedata_start + 0x5C60);
PROVIDE(g_weaponAmmoCapacity = __gamedata_start + 0x5CE8);
PROVIDE(g_weaponXp = __gamedata_start + 0x5CE8);
PROVIDE(D_1398A8 = __gamedata_start + 0x5D28);
PROVIDE(g_anAvailableLevelOrder = __gamedata_start + 0x5DC8);
PROVIDE(D_1399B8 = __gamedata_start + 0x5E38);
PROVIDE(D_139A28 = __gamedata_start + 0x5EA8);
PROVIDE(g_mapBlipTable = __gamedata_start + 0x5EA8);
PROVIDE(g_weaponUpgradeLevel = __gamedata_start + 0x5EB4);
PROVIDE(D_0013A308 = __gamedata_start + 0x6788);
PROVIDE(D_0013A370 = __gamedata_start + 0x67F0);
PROVIDE(D_0013A730 = __gamedata_start + 0x6BB0);
PROVIDE(D_0013A740 = __gamedata_start + 0x6BC0);
PROVIDE(D_0013A750 = __gamedata_start + 0x6BD0);
PROVIDE(D_0013A768 = __gamedata_start + 0x6BE8);
PROVIDE(D_0013A770 = __gamedata_start + 0x6BF0);
PROVIDE(D_0013A788 = __gamedata_start + 0x6C08);
PROVIDE(D_0013A920 = __gamedata_start + 0x6DA0);
PROVIDE(D_0013A948 = __gamedata_start + 0x6DC8);
PROVIDE(D_0013A970 = __gamedata_start + 0x6DF0);
PROVIDE(D_0013A988 = __gamedata_start + 0x6E08);
PROVIDE(D_0013A9A0 = __gamedata_start + 0x6E20);
PROVIDE(D_0013A9C0 = __gamedata_start + 0x6E40);
PROVIDE(D_0013A9C8 = __gamedata_start + 0x6E48);
PROVIDE(D_0013A9D0 = __gamedata_start + 0x6E50);
PROVIDE(D_0013ABA0 = __gamedata_start + 0x7020);
PROVIDE(D_0013ABB0 = __gamedata_start + 0x7030);
PROVIDE(D_0013B208 = __gamedata_start + 0x7688);
PROVIDE(D_0013B218 = __gamedata_start + 0x7698);
PROVIDE(D_0013B268 = __gamedata_start + 0x76E8);
PROVIDE(D_0013B288 = __gamedata_start + 0x7708);
PROVIDE(D_0013B2E0 = __gamedata_start + 0x7760);
PROVIDE(D_0013B2F8 = __gamedata_start + 0x7778);
PROVIDE(D_0013B308 = __gamedata_start + 0x7788);
PROVIDE(D_0013B328 = __gamedata_start + 0x77A8);
PROVIDE(D_0013B348 = __gamedata_start + 0x77C8);
PROVIDE(D_0013B358 = __gamedata_start + 0x77D8);
PROVIDE(D_0013B390 = __gamedata_start + 0x7810);
PROVIDE(D_0013B4E0 = __gamedata_start + 0x7960);
PROVIDE(D_0013B6F0 = __gamedata_start + 0x7B70);
PROVIDE(D_0013B708 = __gamedata_start + 0x7B88);
PROVIDE(D_0013B730 = __gamedata_start + 0x7BB0);
PROVIDE(D_0013B740 = __gamedata_start + 0x7BC0);
PROVIDE(D_0013B750 = __gamedata_start + 0x7BD0);
PROVIDE(D_0013B760 = __gamedata_start + 0x7BE0);
PROVIDE(D_0013B778 = __gamedata_start + 0x7BF8);
PROVIDE(D_0013B7A0 = __gamedata_start + 0x7C20);
PROVIDE(D_0013B7E8 = __gamedata_start + 0x7C68);
PROVIDE(D_0013B800 = __gamedata_start + 0x7C80);
PROVIDE(D_0013B828 = __gamedata_start + 0x7CA8);
PROVIDE(D_0013B850 = __gamedata_start + 0x7CD0);
PROVIDE(D_0013B868 = __gamedata_start + 0x7CE8);
PROVIDE(D_0013B888 = __gamedata_start + 0x7D08);
PROVIDE(D_0013B8C8 = __gamedata_start + 0x7D48);
PROVIDE(D_0013B990 = __gamedata_start + 0x7E10);
PROVIDE(D_0013B9B0 = __gamedata_start + 0x7E30);
PROVIDE(D_0013B9F8 = __gamedata_start + 0x7E78);
PROVIDE(D_0013BA20 = __gamedata_start + 0x7EA0);
PROVIDE(D_0013BA40 = __gamedata_start + 0x7EC0);
PROVIDE(D_0013BA60 = __gamedata_start + 0x7EE0);
PROVIDE(D_0013BA80 = __gamedata_start + 0x7F00);
PROVIDE(D_0013BA98 = __gamedata_start + 0x7F18);
PROVIDE(D_0013BAB8 = __gamedata_start + 0x7F38);
PROVIDE(D_0013BAF0 = __gamedata_start + 0x7F70);
PROVIDE(D_0013BB10 = __gamedata_start + 0x7F90);
PROVIDE(D_0013BB38 = __gamedata_start + 0x7FB8);
PROVIDE(D_0013BB58 = __gamedata_start + 0x7FD8);
PROVIDE(D_0013BB78 = __gamedata_start + 0x7FF8);
PROVIDE(D_0013BBA8 = __gamedata_start + 0x8028);
PROVIDE(D_0013BBC8 = __gamedata_start + 0x8048);
PROVIDE(D_0013BBF8 = __gamedata_start + 0x8078);
PROVIDE(D_0013BC20 = __gamedata_start + 0x80A0);
PROVIDE(D_0013BC50 = __gamedata_start + 0x80D0);
PROVIDE(D_0013BC70 = __gamedata_start + 0x80F0);
PROVIDE(D_0013BC90 = __gamedata_start + 0x8110);
PROVIDE(D_0013BCC0 = __gamedata_start + 0x8140);
PROVIDE(D_0013BCD8 = __gamedata_start + 0x8158);
PROVIDE(D_0013BCE8 = __gamedata_start + 0x8168);
PROVIDE(D_0013BD20 = __gamedata_start + 0x81A0);
PROVIDE(D_0013BD48 = __gamedata_start + 0x81C8);
PROVIDE(D_0013BD68 = __gamedata_start + 0x81E8);
PROVIDE(D_0013BDC8 = __gamedata_start + 0x8248);
PROVIDE(D_0013BDE8 = __gamedata_start + 0x8268);
PROVIDE(D_0013BDF8 = __gamedata_start + 0x8278);
PROVIDE(D_0013BE10 = __gamedata_start + 0x8290);
PROVIDE(D_0013BE38 = __gamedata_start + 0x82B8);
PROVIDE(D_0013BE58 = __gamedata_start + 0x82D8);
PROVIDE(D_0013BE88 = __gamedata_start + 0x8308);
PROVIDE(D_0013BEA0 = __gamedata_start + 0x8320);
PROVIDE(D_0013BED8 = __gamedata_start + 0x8358);
PROVIDE(D_0013BF50 = __gamedata_start + 0x83D0);
PROVIDE(D_0013BF60 = __gamedata_start + 0x83E0);
PROVIDE(D_0013BF78 = __gamedata_start + 0x83F8);
PROVIDE(D_0013BF90 = __gamedata_start + 0x8410);
PROVIDE(D_0013BFA0 = __gamedata_start + 0x8420);
PROVIDE(D_0013BFF8 = __gamedata_start + 0x8478);
PROVIDE(D_0013C100 = __gamedata_start + 0x8580);
PROVIDE(D_0013C180 = __gamedata_start + 0x8600);
PROVIDE(D_0013C200 = __gamedata_start + 0x8680);
PROVIDE(D_0013C600 = __gamedata_start + 0x8A80);
PROVIDE(D_0013C608 = __gamedata_start + 0x8A88);
PROVIDE(D_0013CA10 = __gamedata_start + 0x8E90);
PROVIDE(D_0013CA40 = __gamedata_start + 0x8EC0);
PROVIDE(D_0013CB50 = __gamedata_start + 0x8FD0);
PROVIDE(D_0013CB80 = __gamedata_start + 0x9000);
PROVIDE(D_0013CCC0 = __gamedata_start + 0x9140);
PROVIDE(D_0013CE00 = __gamedata_start + 0x9280);
PROVIDE(D_0013CF54 = __gamedata_start + 0x93D4);
PROVIDE(D_0013CF60 = __gamedata_start + 0x93E0);
PROVIDE(D_0013CF64 = __gamedata_start + 0x93E4);
PROVIDE(D_0013CF6C = __gamedata_start + 0x93EC);
PROVIDE(D_0013D080 = __gamedata_start + 0x9500);
PROVIDE(D_0013D100 = __gamedata_start + 0x9580);
PROVIDE(D_0013D900 = __gamedata_start + 0x9D80);
PROVIDE(D_0013E100 = __gamedata_start + 0xA580);
PROVIDE(D_0013E900 = __gamedata_start + 0xAD80);
PROVIDE(D_0013E940 = __gamedata_start + 0xADC0);
PROVIDE(D_0013E980 = __gamedata_start + 0xAE00);
PROVIDE(D_0013F5C0 = __gamedata_start + 0xBA40);
PROVIDE(D_0013F600 = __gamedata_start + 0xBA80);
PROVIDE(D_0013FE80 = __gamedata_start + 0xC300);
PROVIDE(D_00140080 = __gamedata_start + 0xC500);
PROVIDE(D_001400A8 = __gamedata_start + 0xC528);
PROVIDE(D_001400C0 = __gamedata_start + 0xC540);
PROVIDE(D_00140100 = __gamedata_start + 0xC580);
PROVIDE(D_00140140 = __gamedata_start + 0xC5C0);
PROVIDE(D_00140180 = __gamedata_start + 0xC600);
PROVIDE(D_001401C0 = __gamedata_start + 0xC640);
PROVIDE(D_00140300 = __gamedata_start + 0xC780);
PROVIDE(D_00140500 = __gamedata_start + 0xC980);
PROVIDE(D_00140528 = __gamedata_start + 0xC9A8);
PROVIDE(D_001417EC = __gamedata_start + 0xDC6C);
PROVIDE(D_001417F0 = __gamedata_start + 0xDC70);
PROVIDE(D_00141800 = __gamedata_start + 0xDC80);
PROVIDE(D_00141808 = __gamedata_start + 0xDC88);
PROVIDE(D_00141810 = __gamedata_start + 0xDC90);
PROVIDE(D_00141840 = __gamedata_start + 0xDCC0);
PROVIDE(D_00141844 = __gamedata_start + 0xDCC4);
PROVIDE(D_00141848 = __gamedata_start + 0xDCC8);
PROVIDE(D_00141850 = __gamedata_start + 0xDCD0);
PROVIDE(D_00141A68 = __gamedata_start + 0xDEE8);
PROVIDE(D_00141AC0 = __gamedata_start + 0xDF40);
PROVIDE(D_00141AD8 = __gamedata_start + 0xDF58);
PROVIDE(g_mcRpcClient = __gamedata_start + 0xDF80);
PROVIDE(D_00141B28 = __gamedata_start + 0xDFA8);
PROVIDE(D_00141B2C = __gamedata_start + 0xDFAC);
PROVIDE(D_00141B30 = __gamedata_start + 0xDFB0);
PROVIDE(D_00141B80 = __gamedata_start + 0xE000);
PROVIDE(g_mcRpcRequest = __gamedata_start + 0xE000);
PROVIDE(D_00141BB0 = __gamedata_start + 0xE030);
PROVIDE(D_00142000 = __gamedata_start + 0xE480);
PROVIDE(g_mcRpcResult = __gamedata_start + 0xF540);
PROVIDE(D_00143108 = __gamedata_start + 0xF588);
PROVIDE(D_00143130 = __gamedata_start + 0xF5B0);
PROVIDE(D_00143180 = __gamedata_start + 0xF600);
PROVIDE(D_00143580 = __gamedata_start + 0xFA00);
PROVIDE(D_00143600 = __gamedata_start + 0xFA80);
PROVIDE(D_00143640 = __gamedata_start + 0xFAC0);
PROVIDE(D_00147CC0 = __gamedata_start + 0x14140);
PROVIDE(g_discToc = __gamedata_start + 0x179C0);
PROVIDE(g_globalWadBaseLbn = __gamedata_start + 0x17D2C);
PROVIDE(D_14D11C = __gamedata_start + 0x1959C);
PROVIDE(g_sceneWadBaseLbn = __gamedata_start + 0x1B7E4);
PROVIDE(g_gadgetClassToc = __gamedata_start + 0x1C500);
PROVIDE(g_levelTocHeader = __gamedata_start + 0x1CC58);
PROVIDE(g_levelDialogToc = __gamedata_start + 0x1DCD0);
PROVIDE(g_loadedShipModelVariant = __gamedata_start + 0x1F098);
PROVIDE(g_exitSceneMode = __gamedata_start + 0x1F0A0);
PROVIDE(D_00152C28 = __gamedata_start + 0x1F0A8);
PROVIDE(g_scenePlayerFadedOut = __gamedata_start + 0x1F0AC);
PROVIDE(g_loadedShipTextureIndex = __gamedata_start + 0x1F0B0);
PROVIDE(g_loadingScenesPlayed = __gamedata_start + 0x1F0E8);
PROVIDE(g_respawnPlayerYaw = __gamedata_start + 0x1F108);
PROVIDE(D_152CD0 = __gamedata_start + 0x1F150);
PROVIDE(D_152CE4 = __gamedata_start + 0x1F164);
PROVIDE(g_gadgetClassSramBase = __gamedata_start + 0x1F190);
PROVIDE(g_bestiaryKillCounts = __gamedata_start + 0x54990);
PROVIDE(g_listenerPosHistory = __gamedata_start + 0x54AE0);
PROVIDE(g_sndChannelVolumes = __gamedata_start + 0x54B28);
PROVIDE(g_soundEmitterTable = __gamedata_start + 0x54B50);
PROVIDE(g_soundBankHandles = __gamedata_start + 0x56280);
PROVIDE(g_soundBankHandlesBlk = __gamedata_start + 0x562A0);
PROVIDE(g_flHeroPos = __gamedata_start + 0x56320);
PROVIDE(g_heroPos = __gamedata_start + 0x56320);
PROVIDE(g_heroPosVec = __gamedata_start + 0x56320);
PROVIDE(g_heroOrientVec = __gamedata_start + 0x56330);
PROVIDE(D_189EB8 = __gamedata_start + 0x56338);
PROVIDE(g_heroPos_D0 = __gamedata_start + 0x563F0);
PROVIDE(g_nNanotechBonusHealTimer = __gamedata_start + 0x5647C);
PROVIDE(D_18A000 = __gamedata_start + 0x56480);
PROVIDE(g_heroFacingDir = __gamedata_start + 0x56560);
PROVIDE(D_0018A168 = __gamedata_start + 0x565E8);
PROVIDE(D_0018a168 = __gamedata_start + 0x565E8);
PROVIDE(g_mobyClassTable = __gamedata_start + 0x574C0);
PROVIDE(g_cinematicCameraBlock = __gamedata_start + 0x57770);
PROVIDE(D_18B69A = __gamedata_start + 0x57B1A);
PROVIDE(g_pHeroMoby = __gamedata_start + 0x58530);
PROVIDE(g_heroState = __gamedata_start + 0x58534);
PROVIDE(D_18C0BC = __gamedata_start + 0x5853C);
PROVIDE(g_bPlayerMode = __gamedata_start + 0x58554);
PROVIDE(g_bGlobalSceneActive = __gamedata_start + 0x58555);
PROVIDE(g_activeGadgetItem = __gamedata_start + 0x58568);
PROVIDE(g_cameraZoneType = __gamedata_start + 0x58740);
PROVIDE(g_health = __gamedata_start + 0x5876C);
PROVIDE(D_18D0E8 = __gamedata_start + 0x59568);
PROVIDE(g_platinumBoltFlags = __gamedata_start + 0x676F8);
PROVIDE(g_saveImageGlobal = __gamedata_start + 0x6F028);
PROVIDE(g_saveImageArea = __gamedata_start + 0x71828);
PROVIDE(g_fileLoadVoiceState = __gamedata_start + 0x72828);
PROVIDE(g_fileLoadState = __gamedata_start + 0x7282C);
PROVIDE(g_nFileLoadState = __gamedata_start + 0x7282C);
PROVIDE(g_pendingDialogVoiceId = __gamedata_start + 0x7284C);
PROVIDE(g_pendingVoiceId = __gamedata_start + 0x7284C);
PROVIDE(g_pendingVoiceAux = __gamedata_start + 0x72850);
PROVIDE(g_cdReadMode = __gamedata_start + 0x72868);
PROVIDE(D_1A63F0 = __gamedata_start + 0x72870);
PROVIDE(g_dialogBusy = __gamedata_start + 0x72890);
PROVIDE(g_dialogVoiceActive = __gamedata_start + 0x72890);
PROVIDE(g_dialogVoiceId = __gamedata_start + 0x72894);
PROVIDE(g_dialogVoicePhase = __gamedata_start + 0x7289A);
PROVIDE(g_gsScreenContext = __gamedata_start + 0x72900);
PROVIDE(D_001A65E0 = __gamedata_start + 0x72A60);
PROVIDE(D_001A65E2 = __gamedata_start + 0x72A62);
PROVIDE(g_screenBlitPacketB = __gamedata_start + 0x72CE0);
PROVIDE(D_001A7040 = __gamedata_start + 0x734C0);
PROVIDE(D_001A7080 = __gamedata_start + 0x73500);
PROVIDE(D_001A7084 = __gamedata_start + 0x73504);
PROVIDE(D_001A70C0 = __gamedata_start + 0x73540);
PROVIDE(D_001A7100 = __gamedata_start + 0x73580);
PROVIDE(g_sndIopLoadStatus = __gamedata_start + 0x73590);
PROVIDE(D_001A713F = __gamedata_start + 0x735BF);
PROVIDE(D_001A7140 = __gamedata_start + 0x735C0);
PROVIDE(D_001A7180 = __gamedata_start + 0x73600);
PROVIDE(D_001A71C0 = __gamedata_start + 0x73640);
PROVIDE(D_001A71C4 = __gamedata_start + 0x73644);
PROVIDE(g_hblankTicksAccum = __gamedata_start + 0x73680);
PROVIDE(g_vblankCount = __gamedata_start + 0x73688);
PROVIDE(D_001A7210 = __gamedata_start + 0x73690);
PROVIDE(g_levelStagingState = __gamedata_start + 0x73700);
PROVIDE(g_bLoadingSceneBanksHeld = __gamedata_start + 0x73704);
PROVIDE(g_pLoadedSegment = __gamedata_start + 0x73708);
PROVIDE(g_pStagedChunkB = __gamedata_start + 0x7370C);
PROVIDE(g_loadedArmorVariant = __gamedata_start + 0x73710);
PROVIDE(g_pPlayerModelBuffer = __gamedata_start + 0x73714);
PROVIDE(g_playerTexCount = __gamedata_start + 0x73718);
PROVIDE(g_playerTexDescriptors = __gamedata_start + 0x73720);
PROVIDE(g_loadedHeldItemModelId = __gamedata_start + 0x73740);
PROVIDE(g_heldItemTexDescriptor = __gamedata_start + 0x73748);
PROVIDE(g_vramAllocCursor = __gamedata_start + 0x73750);
PROVIDE(g_vramDynamicBase = __gamedata_start + 0x73754);
PROVIDE(g_vramFrameBufA = __gamedata_start + 0x73758);
PROVIDE(g_vramFrameBufB = __gamedata_start + 0x7375C);
PROVIDE(g_vramZBuffer = __gamedata_start + 0x73760);
PROVIDE(g_vramTextureBase = __gamedata_start + 0x73764);
PROVIDE(D_1A72E8 = __gamedata_start + 0x73768);
PROVIDE(D_1A72EC = __gamedata_start + 0x7376C);
PROVIDE(D_1A72F0 = __gamedata_start + 0x73770);
PROVIDE(D_1A72F4 = __gamedata_start + 0x73774);
PROVIDE(g_vramTextureBase_28 = __gamedata_start + 0x7378C);
PROVIDE(D_001A7318 = __gamedata_start + 0x73798);
PROVIDE(D_1A7318 = __gamedata_start + 0x73798);
PROVIDE(g_nScreenWidth = __gamedata_start + 0x737C0);
PROVIDE(g_screenWidth = __gamedata_start + 0x737C0);
PROVIDE(g_nScreenHeight = __gamedata_start + 0x737C4);
PROVIDE(g_screenHeight = __gamedata_start + 0x737C4);
PROVIDE(g_screenCenterDefaultX = __gamedata_start + 0x737C8);
PROVIDE(g_screenCenterDefaultY = __gamedata_start + 0x737CC);
PROVIDE(g_gsPixelOffsetX = __gamedata_start + 0x737D0);
PROVIDE(g_nGsPixelOffsetX = __gamedata_start + 0x737D0);
PROVIDE(g_gsPixelOffsetY = __gamedata_start + 0x737D4);
PROVIDE(g_nGsPixelOffsetY = __gamedata_start + 0x737D4);
PROVIDE(D_1A7358 = __gamedata_start + 0x737D8);
PROVIDE(D_1A735C = __gamedata_start + 0x737DC);
PROVIDE(D_001A7360 = __gamedata_start + 0x737E0);
PROVIDE(g_saveClock = __gamedata_start + 0x737E0);
PROVIDE(g_itemEquipSlotTable = __gamedata_start + 0x73818);
PROVIDE(g_equippedItemSlots = __gamedata_start + 0x73838);
PROVIDE(g_nSaveLoadStatusCode = __gamedata_start + 0x738A0);
PROVIDE(D_001A7424 = __gamedata_start + 0x738A4);
PROVIDE(g_gameStateFlags = __gamedata_start + 0x738A4);
PROVIDE(g_gsScreenContextPtr = __gamedata_start + 0x738AC);
PROVIDE(g_rawReadStallTimer = __gamedata_start + 0x738B0);
PROVIDE(g_bRawReadFellBack = __gamedata_start + 0x738B4);
PROVIDE(g_bRawReadFellBack_34 = __gamedata_start + 0x738E8);
PROVIDE(g_cinematicExitPending = __gamedata_start + 0x738F8);
PROVIDE(D_001A7480 = __gamedata_start + 0x73900);
PROVIDE(D_001A7484 = __gamedata_start + 0x73904);
PROVIDE(D_001A7488 = __gamedata_start + 0x73908);
PROVIDE(g_sndIopReady = __gamedata_start + 0x7390C);
PROVIDE(D_001A7490 = __gamedata_start + 0x73910);
PROVIDE(D_001A7494 = __gamedata_start + 0x73914);
PROVIDE(D_001A7498 = __gamedata_start + 0x73918);
PROVIDE(D_001A74A0 = __gamedata_start + 0x73920);
PROVIDE(D_001A74A8 = __gamedata_start + 0x73928);
PROVIDE(D_001A74B0 = __gamedata_start + 0x73930);
PROVIDE(D_001A74B8 = __gamedata_start + 0x73938);
PROVIDE(D_001A74C0 = __gamedata_start + 0x73940);
PROVIDE(D_001A74C4 = __gamedata_start + 0x73944);
PROVIDE(D_001A74C8 = __gamedata_start + 0x73948);
PROVIDE(D_001A74D0 = __gamedata_start + 0x73950);
PROVIDE(D_001A74D8 = __gamedata_start + 0x73958);
PROVIDE(D_001A74F8 = __gamedata_start + 0x73978);
PROVIDE(D_001A7578 = __gamedata_start + 0x739F8);
PROVIDE(D_001A7600 = __gamedata_start + 0x73A80);
PROVIDE(D_001A7630 = __gamedata_start + 0x73AB0);
PROVIDE(D_001A7650 = __gamedata_start + 0x73AD0);
PROVIDE(D_001A76F8 = __gamedata_start + 0x73B78);
PROVIDE(D_001A7730 = __gamedata_start + 0x73BB0);
PROVIDE(D_001A7760 = __gamedata_start + 0x73BE0);
PROVIDE(D_001A78D0 = __gamedata_start + 0x73D50);
PROVIDE(g_rawReadSpindleCtrl = __gamedata_start + 0x73D80);
PROVIDE(D_1A7904 = __gamedata_start + 0x73D84);
PROVIDE(D_1A7908 = __gamedata_start + 0x73D88);
PROVIDE(D_1A790C = __gamedata_start + 0x73D8C);
PROVIDE(D_1A7910 = __gamedata_start + 0x73D90);
PROVIDE(D_1A7914 = __gamedata_start + 0x73D94);
PROVIDE(D_1A7918 = __gamedata_start + 0x73D98);
PROVIDE(D_1A791C = __gamedata_start + 0x73D9C);
PROVIDE(D_1A7920 = __gamedata_start + 0x73DA0);
PROVIDE(D_1A792C = __gamedata_start + 0x73DAC);
PROVIDE(g_saveDirTemplate = __gamedata_start + 0x73DB8);
PROVIDE(D_1A7950 = __gamedata_start + 0x73DD0);
PROVIDE(g_saveIconSysPath = __gamedata_start + 0x73DE8);
PROVIDE(g_saveStaticIcoPath = __gamedata_start + 0x73E08);
PROVIDE(D_1A79A8 = __gamedata_start + 0x73E28);
PROVIDE(g_saveFileFmt = __gamedata_start + 0x73E58);
PROVIDE(g_playerProgress = __gamedata_start + 0x73E78);
PROVIDE(g_boltCount = __gamedata_start + 0x73E80);
PROVIDE(g_maxHealth = __gamedata_start + 0x73E88);
PROVIDE(D_1A7A0C = __gamedata_start + 0x73E8C);
PROVIDE(D_1A7A10 = __gamedata_start + 0x73E90);
PROVIDE(g_miscExtras = __gamedata_start + 0x73E92);
PROVIDE(D_1A7A13 = __gamedata_start + 0x73E93);
PROVIDE(g_nanotech = __gamedata_start + 0x73E94);
PROVIDE(g_nPendingNanotechXp = __gamedata_start + 0x73E98);
PROVIDE(g_pendingBoltCredit = __gamedata_start + 0x73E9C);
PROVIDE(g_equippedArmor = __gamedata_start + 0x73EA0);
PROVIDE(D_1A7A3A = __gamedata_start + 0x73EBA);
PROVIDE(D_1A7A3B = __gamedata_start + 0x73EBB);
PROVIDE(g_cheatFlags = __gamedata_start + 0x73EC8);
PROVIDE(D_1A7A4A = __gamedata_start + 0x73ECA);
PROVIDE(D_1A7A4C = __gamedata_start + 0x73ECC);
PROVIDE(D_1A7A4F = __gamedata_start + 0x73ECF);
PROVIDE(D_1A7A51 = __gamedata_start + 0x73ED1);
PROVIDE(D_1A7A52 = __gamedata_start + 0x73ED2);
PROVIDE(D_1A7A53 = __gamedata_start + 0x73ED3);
PROVIDE(D_1A7A58 = __gamedata_start + 0x73ED8);
PROVIDE(g_skillPointFlags = __gamedata_start + 0x73EE8);
PROVIDE(g_itemStateFlags = __gamedata_start + 0x73F08);
PROVIDE(D_1A7AC0 = __gamedata_start + 0x73F40);
PROVIDE(g_shipCustomization = __gamedata_start + 0x73F78);
PROVIDE(D_1A7AFA = __gamedata_start + 0x73F7A);
PROVIDE(g_inventoryOwned = __gamedata_start + 0x73F80);
PROVIDE(D_1A7B05 = __gamedata_start + 0x73F85);
PROVIDE(g_mapDataSet = __gamedata_start + 0x73F85);
PROVIDE(D_1A7B0D = __gamedata_start + 0x73F8D);
PROVIDE(D_1A7B10 = __gamedata_start + 0x73F90);
PROVIDE(D_1A7B14 = __gamedata_start + 0x73F94);
PROVIDE(g_inventoryNewFlag = __gamedata_start + 0x73FB8);
PROVIDE(g_inventoryOrder = __gamedata_start + 0x73FF0);
PROVIDE(D_1A7B90 = __gamedata_start + 0x74010);
PROVIDE(g_nSavePromptPending = __gamedata_start + 0x74014);
PROVIDE(g_bPalMode = __gamedata_start + 0x74018);
PROVIDE(D_1A7B9C = __gamedata_start + 0x7401C);
PROVIDE(D_1A7B9D = __gamedata_start + 0x7401D);
PROVIDE(D_1A7B9E = __gamedata_start + 0x7401E);
PROVIDE(g_audioStereoMode = __gamedata_start + 0x74020);
PROVIDE(g_nAudioStereoMode = __gamedata_start + 0x74020);
PROVIDE(D_1A7BA4 = __gamedata_start + 0x74024);
PROVIDE(g_nSfxVolume = __gamedata_start + 0x74024);
PROVIDE(g_sfxVolume = __gamedata_start + 0x74024);
PROVIDE(D_1A7BA8 = __gamedata_start + 0x74028);
PROVIDE(g_musicVolume = __gamedata_start + 0x74028);
PROVIDE(g_nMusicVolume = __gamedata_start + 0x74028);
PROVIDE(D_1A7BAC = __gamedata_start + 0x7402C);
PROVIDE(D_1A7BB0 = __gamedata_start + 0x74030);
PROVIDE(D_1A7BB4 = __gamedata_start + 0x74034);
PROVIDE(D_1A7BB9 = __gamedata_start + 0x74039);
PROVIDE(D_1A7BBA = __gamedata_start + 0x7403A);
PROVIDE(D_1A7BBB = __gamedata_start + 0x7403B);
PROVIDE(g_currentLanguage = __gamedata_start + 0x7403C);
PROVIDE(g_bProgressiveScan = __gamedata_start + 0x74040);
PROVIDE(D_1A7BC8 = __gamedata_start + 0x74048);
PROVIDE(g_abLevelAvailableFlags = __gamedata_start + 0x74050);
PROVIDE(D_1A7BD1 = __gamedata_start + 0x74051);
PROVIDE(D_1A7BD2 = __gamedata_start + 0x74052);
PROVIDE(D_1A7BD3 = __gamedata_start + 0x74053);
PROVIDE(D_1A7BD4 = __gamedata_start + 0x74054);
PROVIDE(D_1A7BD6 = __gamedata_start + 0x74056);
PROVIDE(D_1A7BDD = __gamedata_start + 0x7405D);
PROVIDE(g_abLevelVisitedMarkers = __gamedata_start + 0x74070);
PROVIDE(g_levelVisitedMarkers = __gamedata_start + 0x74070);
PROVIDE(D_1A7BF2 = __gamedata_start + 0x74072);
PROVIDE(D_1A7BF4 = __gamedata_start + 0x74074);
PROVIDE(D_1A7BFB = __gamedata_start + 0x7407B);
PROVIDE(D_1A7C06 = __gamedata_start + 0x74086);
PROVIDE(D_1A7C07 = __gamedata_start + 0x74087);
PROVIDE(D_1A7C09 = __gamedata_start + 0x74089);
PROVIDE(D_1A7C0A = __gamedata_start + 0x7408A);
PROVIDE(D_1A7C0C = __gamedata_start + 0x7408C);
PROVIDE(D_001A7C10 = __gamedata_start + 0x74090);
PROVIDE(D_1A85B8 = __gamedata_start + 0x74A38);
PROVIDE(D_1A8630 = __gamedata_start + 0x74AB0);
PROVIDE(D_1A86F0 = __gamedata_start + 0x74B70);
PROVIDE(D_1A86F4 = __gamedata_start + 0x74B74);
PROVIDE(D_1A8758 = __gamedata_start + 0x74BD8);
PROVIDE(D_1A8760 = __gamedata_start + 0x74BE0);
PROVIDE(D_1A8770 = __gamedata_start + 0x74BF0);
PROVIDE(g_screenGrabTex0Full = __gamedata_start + 0x74C00);
PROVIDE(g_screenGrabTex0Half = __gamedata_start + 0x74C08);
PROVIDE(D_1A8790 = __gamedata_start + 0x74C10);
PROVIDE(D_1A8998 = __gamedata_start + 0x74E18);
PROVIDE(D_1A89B0 = __gamedata_start + 0x74E30);
PROVIDE(D_1A8A60 = __gamedata_start + 0x74EE0);
PROVIDE(D_1A8A64 = __gamedata_start + 0x74EE4);
PROVIDE(D_1A8A78 = __gamedata_start + 0x74EF8);
PROVIDE(D_1A8A80 = __gamedata_start + 0x74F00);
PROVIDE(D_1A8AE0 = __gamedata_start + 0x74F60);
PROVIDE(D_1A8B10 = __gamedata_start + 0x74F90);
PROVIDE(D_1A8B40 = __gamedata_start + 0x74FC0);
PROVIDE(g_nLevelExitRequested = __gamedata_start + 0x75004);
PROVIDE(D_001A8B88 = __gamedata_start + 0x75008);
PROVIDE(g_nGameState = __gamedata_start + 0x75030);
PROVIDE(g_nGameStatePrev = __gamedata_start + 0x75034);
PROVIDE(g_nGameStatePending = __gamedata_start + 0x75038);
PROVIDE(g_nGlobalSoundDefs = __gamedata_start + 0x7503C);
PROVIDE(D_1A8BC0 = __gamedata_start + 0x75040);
PROVIDE(D_1A8BD0 = __gamedata_start + 0x75050);
PROVIDE(D_1A8C28 = __gamedata_start + 0x750A8);
PROVIDE(D_1A8C30 = __gamedata_start + 0x750B0);
PROVIDE(D_1A8C38 = __gamedata_start + 0x750B8);
PROVIDE(D_1A8C40 = __gamedata_start + 0x750C0);
PROVIDE(D_1A8C48 = __gamedata_start + 0x750C8);
PROVIDE(D_1A8C50 = __gamedata_start + 0x750D0);
PROVIDE(D_1A8C58 = __gamedata_start + 0x750D8);
PROVIDE(D_1A8C60 = __gamedata_start + 0x750E0);
PROVIDE(D_1A8C64 = __gamedata_start + 0x750E4);
PROVIDE(g_noticeOwner = __gamedata_start + 0x750E4);
PROVIDE(D_1A8C70 = __gamedata_start + 0x750F0);
PROVIDE(g_exitFadeRate = __gamedata_start + 0x750FC);
PROVIDE(g_exitCinematicCallback = __gamedata_start + 0x75100);
PROVIDE(g_exitCinematicCallbackArg = __gamedata_start + 0x75104);
PROVIDE(D_001A8C88 = __gamedata_start + 0x75108);
PROVIDE(D_1A8C88 = __gamedata_start + 0x75108);
PROVIDE(D_001A8C8C = __gamedata_start + 0x7510C);
PROVIDE(D_1A8C8C = __gamedata_start + 0x7510C);
PROVIDE(D_1A8CA0 = __gamedata_start + 0x75120);
PROVIDE(g_altGravityEnabled = __gamedata_start + 0x75120);
PROVIDE(D_1A8CA4 = __gamedata_start + 0x75124);
PROVIDE(g_altGravityPlanar = __gamedata_start + 0x75124);
PROVIDE(D_1A8CB0 = __gamedata_start + 0x75130);
PROVIDE(g_altGravityPlanarCenter = __gamedata_start + 0x75130);
PROVIDE(D_1A8CD4 = __gamedata_start + 0x75154);
PROVIDE(D_001A8CEC = __gamedata_start + 0x7516C);
PROVIDE(D_1A8CEC = __gamedata_start + 0x7516C);
PROVIDE(g_guiInstance = __gamedata_start + 0x75184);
PROVIDE(g_pGuiManager = __gamedata_start + 0x75184);
PROVIDE(D_1A8D18 = __gamedata_start + 0x75198);
PROVIDE(D_1A8D20 = __gamedata_start + 0x751A0);
PROVIDE(D_1A8D28 = __gamedata_start + 0x751A8);
PROVIDE(D_1A8D30 = __gamedata_start + 0x751B0);
PROVIDE(D_1A8D40 = __gamedata_start + 0x751C0);
PROVIDE(g_activeMobyTableId = __gamedata_start + 0x751C4);
PROVIDE(D_1A8D48 = __gamedata_start + 0x751C8);
PROVIDE(D_1A8D98 = __gamedata_start + 0x75218);
PROVIDE(D_1A8D9C = __gamedata_start + 0x7521C);
PROVIDE(D_1A8DA0 = __gamedata_start + 0x75220);
PROVIDE(D_1A8DA4 = __gamedata_start + 0x75224);
PROVIDE(D_1A8DB8 = __gamedata_start + 0x75238);
PROVIDE(D_1A8DBC = __gamedata_start + 0x7523C);
PROVIDE(D_1A8DC0 = __gamedata_start + 0x75240);
PROVIDE(D_1A8DC4 = __gamedata_start + 0x75244);
PROVIDE(D_1A8DD0 = __gamedata_start + 0x75250);
PROVIDE(D_1A8DD8 = __gamedata_start + 0x75258);
PROVIDE(D_1A8DE0 = __gamedata_start + 0x75260);
PROVIDE(D_1A8E00 = __gamedata_start + 0x75280);
PROVIDE(D_1A8E08 = __gamedata_start + 0x75288);
PROVIDE(D_1A8E10 = __gamedata_start + 0x75290);
PROVIDE(g_szAmmoFraction = __gamedata_start + 0x752A8);
PROVIDE(D_1A8E30 = __gamedata_start + 0x752B0);
PROVIDE(D_1A8E70 = __gamedata_start + 0x752F0);
PROVIDE(D_1A8FB0 = __gamedata_start + 0x75430);
PROVIDE(D_1A8FB4 = __gamedata_start + 0x75434);
PROVIDE(D_1A8FB8 = __gamedata_start + 0x75438);
PROVIDE(D_1A8FBC = __gamedata_start + 0x7543C);
PROVIDE(D_1A9000 = __gamedata_start + 0x75480);
PROVIDE(D_1A9004 = __gamedata_start + 0x75484);
PROVIDE(D_1A9008 = __gamedata_start + 0x75488);
PROVIDE(D_1A900C = __gamedata_start + 0x7548C);
PROVIDE(D_1A9010 = __gamedata_start + 0x75490);
PROVIDE(D_1A9014 = __gamedata_start + 0x75494);
PROVIDE(D_1A9018 = __gamedata_start + 0x75498);
PROVIDE(D_1A901C = __gamedata_start + 0x7549C);
PROVIDE(D_1A9020 = __gamedata_start + 0x754A0);
PROVIDE(D_1A9048 = __gamedata_start + 0x754C8);
PROVIDE(D_1A9060 = __gamedata_start + 0x754E0);
PROVIDE(D_1A9070 = __gamedata_start + 0x754F0);
PROVIDE(D_1A9190 = __gamedata_start + 0x75610);
PROVIDE(D_1A91C0 = __gamedata_start + 0x75640);
PROVIDE(D_1A91D0 = __gamedata_start + 0x75650);
PROVIDE(D_1A91E0 = __gamedata_start + 0x75660);
PROVIDE(D_1A91F0 = __gamedata_start + 0x75670);
PROVIDE(D_1A9200 = __gamedata_start + 0x75680);
PROVIDE(D_1A9210 = __gamedata_start + 0x75690);
PROVIDE(D_1A9220 = __gamedata_start + 0x756A0);
PROVIDE(D_1A9230 = __gamedata_start + 0x756B0);
PROVIDE(D_1A9240 = __gamedata_start + 0x756C0);
PROVIDE(D_1A9330 = __gamedata_start + 0x757B0);
PROVIDE(D_1A9334 = __gamedata_start + 0x757B4);
PROVIDE(D_1A9338 = __gamedata_start + 0x757B8);
PROVIDE(D_1A933C = __gamedata_start + 0x757BC);
PROVIDE(D_1A9340 = __gamedata_start + 0x757C0);
PROVIDE(D_1A9370 = __gamedata_start + 0x757F0);
PROVIDE(D_1A93B0 = __gamedata_start + 0x75830);
PROVIDE(D_1A9428 = __gamedata_start + 0x758A8);
PROVIDE(D_1A95C0 = __gamedata_start + 0x75A40);
PROVIDE(D_1A95C4 = __gamedata_start + 0x75A44);
PROVIDE(D_1A95D8 = __gamedata_start + 0x75A58);
PROVIDE(D_1A95DC = __gamedata_start + 0x75A5C);
PROVIDE(D_1A95E0 = __gamedata_start + 0x75A60);
PROVIDE(D_1A95E4 = __gamedata_start + 0x75A64);
PROVIDE(D_1A95E8 = __gamedata_start + 0x75A68);
PROVIDE(D_1A95EC = __gamedata_start + 0x75A6C);
PROVIDE(D_1A95F0 = __gamedata_start + 0x75A70);
PROVIDE(D_1A95F8 = __gamedata_start + 0x75A78);
PROVIDE(D_1A95FC = __gamedata_start + 0x75A7C);
PROVIDE(D_1A9600 = __gamedata_start + 0x75A80);
PROVIDE(D_1A9604 = __gamedata_start + 0x75A84);
PROVIDE(D_1A9608 = __gamedata_start + 0x75A88);
PROVIDE(D_1A960C = __gamedata_start + 0x75A8C);
PROVIDE(D_1A9610 = __gamedata_start + 0x75A90);
PROVIDE(D_1A9614 = __gamedata_start + 0x75A94);
PROVIDE(D_1A9618 = __gamedata_start + 0x75A98);
PROVIDE(D_1A961C = __gamedata_start + 0x75A9C);
PROVIDE(D_1A9620 = __gamedata_start + 0x75AA0);
PROVIDE(D_1A9624 = __gamedata_start + 0x75AA4);
PROVIDE(D_1A9628 = __gamedata_start + 0x75AA8);
PROVIDE(D_1A962C = __gamedata_start + 0x75AAC);
PROVIDE(D_1A9630 = __gamedata_start + 0x75AB0);
PROVIDE(D_1A9634 = __gamedata_start + 0x75AB4);
PROVIDE(D_1A9658 = __gamedata_start + 0x75AD8);
PROVIDE(D_1A9718 = __gamedata_start + 0x75B98);
PROVIDE(D_1A9758 = __gamedata_start + 0x75BD8);
PROVIDE(D_1A9760 = __gamedata_start + 0x75BE0);
PROVIDE(D_1A99A0 = __gamedata_start + 0x75E20);
PROVIDE(g_changedSaveSectionCount = __gamedata_start + 0x75E20);
PROVIDE(D_1A99A8 = __gamedata_start + 0x75E28);
PROVIDE(D_1A9A60 = __gamedata_start + 0x75EE0);
PROVIDE(D_1A9A88 = __gamedata_start + 0x75F08);
PROVIDE(D_1A9A8C = __gamedata_start + 0x75F0C);
PROVIDE(g_menuScreenReady = __gamedata_start + 0x75F0C);
PROVIDE(D_1A9A90 = __gamedata_start + 0x75F10);
PROVIDE(g_menuSelectedButton = __gamedata_start + 0x75F10);
PROVIDE(D_1A9A98 = __gamedata_start + 0x75F18);
PROVIDE(D_1A9AC0 = __gamedata_start + 0x75F40);
PROVIDE(D_1A9AD0 = __gamedata_start + 0x75F50);
PROVIDE(g_menuButtonChainHeads = __gamedata_start + 0x75F50);
PROVIDE(D_001A9AE0 = __gamedata_start + 0x75F60);
PROVIDE(D_1A9DC8 = __gamedata_start + 0x76248);
PROVIDE(D_1A9E48 = __gamedata_start + 0x762C8);
PROVIDE(D_1A9E70 = __gamedata_start + 0x762F0);
PROVIDE(D_1A9E74 = __gamedata_start + 0x762F4);
PROVIDE(D_1A9E94 = __gamedata_start + 0x76314);
PROVIDE(g_colorPulsePhaseA = __gamedata_start + 0x76314);
PROVIDE(D_1A9E98 = __gamedata_start + 0x76318);
PROVIDE(g_colorPulsePhaseB = __gamedata_start + 0x76318);
PROVIDE(D_1A9EA0 = __gamedata_start + 0x76320);
PROVIDE(D_1A9F20 = __gamedata_start + 0x763A0);
PROVIDE(D_1A9F38 = __gamedata_start + 0x763B8);
PROVIDE(D_1A9FCC = __gamedata_start + 0x7644C);
PROVIDE(D_1A9FD0 = __gamedata_start + 0x76450);
PROVIDE(D_1AA030 = __gamedata_start + 0x764B0);
PROVIDE(D_1AA060 = __gamedata_start + 0x764E0);
PROVIDE(D_1AA070 = __gamedata_start + 0x764F0);
PROVIDE(D_1AA080 = __gamedata_start + 0x76500);
PROVIDE(D_1AA090 = __gamedata_start + 0x76510);
PROVIDE(D_1AA0A0 = __gamedata_start + 0x76520);
PROVIDE(D_1AA0B0 = __gamedata_start + 0x76530);
PROVIDE(g_gameStateTransitionTimer = __gamedata_start + 0x76570);
PROVIDE(g_gameStateTransitionDelay = __gamedata_start + 0x76574);
PROVIDE(g_gameStatePendingArgA = __gamedata_start + 0x76578);
PROVIDE(g_gameStatePendingArgB = __gamedata_start + 0x7657C);
PROVIDE(g_gameStateStackDepth = __gamedata_start + 0x76580);
PROVIDE(g_gameStateTransitionDoneFlag = __gamedata_start + 0x76584);
PROVIDE(g_mobyMaxTurnRate = __gamedata_start + 0x76588);
PROVIDE(g_mobyMotionProfileTicks = __gamedata_start + 0x7658C);
PROVIDE(g_mobyMotionProfileCount = __gamedata_start + 0x76594);
PROVIDE(D_1AA170 = __gamedata_start + 0x765F0);
PROVIDE(D_1AA198 = __gamedata_start + 0x76618);  /* const */
PROVIDE(D_1AA1B0 = __gamedata_start + 0x76630);
PROVIDE(D_1AA1C0 = __gamedata_start + 0x76640);
PROVIDE(D_1AA1D0 = __gamedata_start + 0x76650);
PROVIDE(D_1AA1E8 = __gamedata_start + 0x76668);  /* const */
PROVIDE(D_1AA1F8 = __gamedata_start + 0x76678);  /* const */
PROVIDE(D_1AA220 = __gamedata_start + 0x766A0);  /* const */
PROVIDE(D_1AA440 = __gamedata_start + 0x768C0);
PROVIDE(D_1AA448 = __gamedata_start + 0x768C8);
PROVIDE(D_1AA44C = __gamedata_start + 0x768CC);
PROVIDE(D_1AA450 = __gamedata_start + 0x768D0);
PROVIDE(D_1AA454 = __gamedata_start + 0x768D4);
PROVIDE(D_1AA458 = __gamedata_start + 0x768D8);
PROVIDE(D_1AA45C = __gamedata_start + 0x768DC);
PROVIDE(D_1AA460 = __gamedata_start + 0x768E0);
PROVIDE(D_1AA510 = __gamedata_start + 0x76990);
PROVIDE(g_pLevelOrder = __gamedata_start + 0x76990);
PROVIDE(D_1AA5A2 = __gamedata_start + 0x76A22);
PROVIDE(D_1AA5BA = __gamedata_start + 0x76A3A);
PROVIDE(D_1AA5D2 = __gamedata_start + 0x76A52);
PROVIDE(D_1AA5EA = __gamedata_start + 0x76A6A);
PROVIDE(D_1AA602 = __gamedata_start + 0x76A82);
PROVIDE(D_1AA6D8 = __gamedata_start + 0x76B58);
PROVIDE(D_1AA7F8 = __gamedata_start + 0x76C78);
PROVIDE(D_1AA830 = __gamedata_start + 0x76CB0);
PROVIDE(D_1AA850 = __gamedata_start + 0x76CD0);
PROVIDE(D_1AA856 = __gamedata_start + 0x76CD6);
PROVIDE(D_1AA890 = __gamedata_start + 0x76D10);
PROVIDE(D_1AA8B8 = __gamedata_start + 0x76D38);
PROVIDE(D_1AAA58 = __gamedata_start + 0x76ED8);
PROVIDE(D_1AB068 = __gamedata_start + 0x774E8);
PROVIDE(D_1AB098 = __gamedata_start + 0x77518);
PROVIDE(D_001AB2BC = __gamedata_start + 0x7773C);
PROVIDE(D_1AB2BC = __gamedata_start + 0x7773C);
PROVIDE(D_001AB2C0 = __gamedata_start + 0x77740);
PROVIDE(D_1AB2C0 = __gamedata_start + 0x77740);
PROVIDE(D_001AB2C4 = __gamedata_start + 0x77744);
PROVIDE(D_1AB2C4 = __gamedata_start + 0x77744);
PROVIDE(D_001AB2C8 = __gamedata_start + 0x77748);
PROVIDE(D_1AB2C8 = __gamedata_start + 0x77748);
PROVIDE(D_1AB648 = __gamedata_start + 0x77AC8);
PROVIDE(D_1AB678 = __gamedata_start + 0x77AF8);
PROVIDE(D_1AB7C4 = __gamedata_start + 0x77C44);
PROVIDE(D_1AB7C8 = __gamedata_start + 0x77C48);
PROVIDE(D_1AB7F0 = __gamedata_start + 0x77C70);
PROVIDE(D_1AB810 = __gamedata_start + 0x77C90);
PROVIDE(D_1AB828 = __gamedata_start + 0x77CA8);
PROVIDE(D_1AB840 = __gamedata_start + 0x77CC0);
PROVIDE(D_1AB850 = __gamedata_start + 0x77CD0);
PROVIDE(D_1AB858 = __gamedata_start + 0x77CD8);
PROVIDE(D_1AB870 = __gamedata_start + 0x77CF0);
PROVIDE(D_1AB8B0 = __gamedata_start + 0x77D30);
PROVIDE(D_1AB8F0 = __gamedata_start + 0x77D70);
PROVIDE(D_1AB914 = __gamedata_start + 0x77D94);
PROVIDE(D_1AB918 = __gamedata_start + 0x77D98);
PROVIDE(D_1AB920 = __gamedata_start + 0x77DA0);
PROVIDE(D_1AB930 = __gamedata_start + 0x77DB0);
PROVIDE(D_1AB958 = __gamedata_start + 0x77DD8);
PROVIDE(D_1AB978 = __gamedata_start + 0x77DF8);
PROVIDE(D_1AB9B8 = __gamedata_start + 0x77E38);
PROVIDE(D_1AB9D8 = __gamedata_start + 0x77E58);
PROVIDE(D_1AB9DC = __gamedata_start + 0x77E5C);
PROVIDE(D_1AB9E0 = __gamedata_start + 0x77E60);
PROVIDE(D_1AB9E4 = __gamedata_start + 0x77E64);
PROVIDE(g_bestiaryCursor = __gamedata_start + 0x77E68);
PROVIDE(g_bestiaryPrevEntry = __gamedata_start + 0x77E6C);
PROVIDE(g_bestiaryNextEntry = __gamedata_start + 0x77E70);
PROVIDE(D_1AB9F4 = __gamedata_start + 0x77E74);
PROVIDE(D_1AB9F8 = __gamedata_start + 0x77E78);
PROVIDE(D_1ABA00 = __gamedata_start + 0x77E80);
PROVIDE(D_1ABA10 = __gamedata_start + 0x77E90);
PROVIDE(D_1ABA28 = __gamedata_start + 0x77EA8);
PROVIDE(D_1ABA2C = __gamedata_start + 0x77EAC);
PROVIDE(D_1ABA30 = __gamedata_start + 0x77EB0);
PROVIDE(D_1ABA34 = __gamedata_start + 0x77EB4);
PROVIDE(D_1ABA38 = __gamedata_start + 0x77EB8);
PROVIDE(g_nSkillPointsMenuCursor = __gamedata_start + 0x77EBC);
PROVIDE(D_1ABA40 = __gamedata_start + 0x77EC0);
PROVIDE(g_extrasMenuCursor = __gamedata_start + 0x77EC4);
PROVIDE(D_1ABA48 = __gamedata_start + 0x77EC8);
PROVIDE(D_1ABA4C = __gamedata_start + 0x77ECC);
PROVIDE(D_1ABA50 = __gamedata_start + 0x77ED0);
PROVIDE(D_1ABA54 = __gamedata_start + 0x77ED4);
PROVIDE(D_1ABA58 = __gamedata_start + 0x77ED8);
PROVIDE(D_1ABA5C = __gamedata_start + 0x77EDC);
PROVIDE(D_1ABA60 = __gamedata_start + 0x77EE0);
PROVIDE(D_1ABA64 = __gamedata_start + 0x77EE4);
PROVIDE(g_planetWarpCursor = __gamedata_start + 0x77EE8);
PROVIDE(g_planetWarpEnabled = __gamedata_start + 0x77EF0);
PROVIDE(D_1ABA71 = __gamedata_start + 0x77EF1);
PROVIDE(D_1ABA72 = __gamedata_start + 0x77EF2);
PROVIDE(D_1ABA73 = __gamedata_start + 0x77EF3);
PROVIDE(D_1ABA74 = __gamedata_start + 0x77EF4);
PROVIDE(D_1ABA75 = __gamedata_start + 0x77EF5);
PROVIDE(D_1ABA76 = __gamedata_start + 0x77EF6);
PROVIDE(D_1ABA77 = __gamedata_start + 0x77EF7);
PROVIDE(D_1ABA78 = __gamedata_start + 0x77EF8);
PROVIDE(g_museumMenuCursor = __gamedata_start + 0x77EFC);
PROVIDE(D_1ABA80 = __gamedata_start + 0x77F00);
PROVIDE(D_1ABA84 = __gamedata_start + 0x77F04);
PROVIDE(D_1ABA88 = __gamedata_start + 0x77F08);
PROVIDE(D_1ABA8C = __gamedata_start + 0x77F0C);
PROVIDE(D_1ABA90 = __gamedata_start + 0x77F10);
PROVIDE(D_1ABA94 = __gamedata_start + 0x77F14);
PROVIDE(g_helpTopicCursor = __gamedata_start + 0x77F18);
PROVIDE(D_1ABA9C = __gamedata_start + 0x77F1C);
PROVIDE(g_optionsSubCursor = __gamedata_start + 0x77F20);
PROVIDE(D_1ABAA4 = __gamedata_start + 0x77F24);
PROVIDE(g_helpPageCursor = __gamedata_start + 0x77F28);
PROVIDE(D_1ABAAC = __gamedata_start + 0x77F2C);
PROVIDE(D_1ABAB0 = __gamedata_start + 0x77F30);
PROVIDE(g_shipCustomizeCursor = __gamedata_start + 0x77F34);
PROVIDE(D_1ABAD0 = __gamedata_start + 0x77F50);
PROVIDE(D_1ABAD4 = __gamedata_start + 0x77F54);
PROVIDE(D_1ABAD8 = __gamedata_start + 0x77F58);
PROVIDE(D_1ABADC = __gamedata_start + 0x77F5C);
PROVIDE(D_1ABAE0 = __gamedata_start + 0x77F60);
PROVIDE(D_1ABAE4 = __gamedata_start + 0x77F64);
PROVIDE(D_1ABAE8 = __gamedata_start + 0x77F68);
PROVIDE(D_1ABAF0 = __gamedata_start + 0x77F70);
PROVIDE(D_1ABB08 = __gamedata_start + 0x77F88);
PROVIDE(D_1ABB0C = __gamedata_start + 0x77F8C);
PROVIDE(D_1ABB10 = __gamedata_start + 0x77F90);
PROVIDE(D_1ABB14 = __gamedata_start + 0x77F94);
PROVIDE(D_1ABB18 = __gamedata_start + 0x77F98);
PROVIDE(D_1ABB1C = __gamedata_start + 0x77F9C);
PROVIDE(D_1ABB20 = __gamedata_start + 0x77FA0);
PROVIDE(D_1ABB38 = __gamedata_start + 0x77FB8);
PROVIDE(D_1ABB6C = __gamedata_start + 0x77FEC);
PROVIDE(D_1ABB90 = __gamedata_start + 0x78010);
PROVIDE(D_1ABBB0 = __gamedata_start + 0x78030);
PROVIDE(D_1ABBB4 = __gamedata_start + 0x78034);
PROVIDE(D_1ABBB8 = __gamedata_start + 0x78038);
PROVIDE(D_1ABBBC = __gamedata_start + 0x7803C);
PROVIDE(D_1ABBC0 = __gamedata_start + 0x78040);
PROVIDE(D_1ABBC4 = __gamedata_start + 0x78044);
PROVIDE(D_1ABBC8 = __gamedata_start + 0x78048);
PROVIDE(D_1ABBCC = __gamedata_start + 0x7804C);
PROVIDE(D_1ABBE0 = __gamedata_start + 0x78060);
PROVIDE(D_1ABBE8 = __gamedata_start + 0x78068);
PROVIDE(D_1ABBEC = __gamedata_start + 0x7806C);
PROVIDE(D_1ABBF0 = __gamedata_start + 0x78070);
PROVIDE(D_1ABBF4 = __gamedata_start + 0x78074);
PROVIDE(D_001ABBF8 = __gamedata_start + 0x78078);
PROVIDE(D_1ABBF8 = __gamedata_start + 0x78078);
PROVIDE(D_001ABBF9 = __gamedata_start + 0x78079);
PROVIDE(D_001ABC00 = __gamedata_start + 0x78080);
PROVIDE(D_1ABC00 = __gamedata_start + 0x78080);
PROVIDE(D_001ABC01 = __gamedata_start + 0x78081);
PROVIDE(D_1ABC54 = __gamedata_start + 0x780D4);
PROVIDE(g_levelSelectRowLineHeight = __gamedata_start + 0x780D4);
PROVIDE(D_001ABD20 = __gamedata_start + 0x781A0);
PROVIDE(D_1ABD20 = __gamedata_start + 0x781A0);
PROVIDE(g_cheatInputCount = __gamedata_start + 0x781A0);
PROVIDE(D_1ABD48 = __gamedata_start + 0x781C8);
PROVIDE(g_menuSoundEnabled = __gamedata_start + 0x781C8);
PROVIDE(D_1ABD50 = __gamedata_start + 0x781D0);
PROVIDE(D_1ABD80 = __gamedata_start + 0x78200);
PROVIDE(D_1ABD98 = __gamedata_start + 0x78218);
PROVIDE(D_1ABDA8 = __gamedata_start + 0x78228);
PROVIDE(D_1ABDC0 = __gamedata_start + 0x78240);
PROVIDE(D_1ABDE8 = __gamedata_start + 0x78268);
PROVIDE(D_1ABDEA = __gamedata_start + 0x7826A);
PROVIDE(D_1ABE00 = __gamedata_start + 0x78280);
PROVIDE(g_pendingStateArgA = __gamedata_start + 0x78280);
PROVIDE(g_pendingStateArgB = __gamedata_start + 0x78284);
PROVIDE(D_1ABE08 = __gamedata_start + 0x78288);
PROVIDE(D_1ABE10 = __gamedata_start + 0x78290);
PROVIDE(D_1ABE54 = __gamedata_start + 0x782D4);
PROVIDE(D_1ABE58 = __gamedata_start + 0x782D8);
PROVIDE(D_1ABE60 = __gamedata_start + 0x782E0);
PROVIDE(D_1ABE90 = __gamedata_start + 0x78310);
PROVIDE(D_1AC560 = __gamedata_start + 0x789E0);
PROVIDE(D_1AC860 = __gamedata_start + 0x78CE0);
PROVIDE(D_1AC870 = __gamedata_start + 0x78CF0);
PROVIDE(D_1AC880 = __gamedata_start + 0x78D00);
PROVIDE(D_1AC900 = __gamedata_start + 0x78D80);
PROVIDE(D_1AC930 = __gamedata_start + 0x78DB0);
PROVIDE(g_tieDrawTemplate = __gamedata_start + 0x78F60);
PROVIDE(D_1AD110 = __gamedata_start + 0x79590);
PROVIDE(D_1AD1A0 = __gamedata_start + 0x79620);
PROVIDE(D_1AD1F8 = __gamedata_start + 0x79678);
PROVIDE(D_1AD238 = __gamedata_start + 0x796B8);
PROVIDE(g_vendorHasPendingArmor = __gamedata_start + 0x796B8);
PROVIDE(D_1AD23C = __gamedata_start + 0x796BC);
PROVIDE(g_vendorPendingArmor = __gamedata_start + 0x796BC);
PROVIDE(D_1AD240 = __gamedata_start + 0x796C0);
PROVIDE(g_vendorEntryArmor = __gamedata_start + 0x796C0);
PROVIDE(D_1AD244 = __gamedata_start + 0x796C4);
PROVIDE(g_vendorForcedTab = __gamedata_start + 0x796C4);
PROVIDE(D_1AD260 = __gamedata_start + 0x796E0);
PROVIDE(D_1AD270 = __gamedata_start + 0x796F0);
PROVIDE(D_1AD280 = __gamedata_start + 0x79700);
PROVIDE(D_1AD290 = __gamedata_start + 0x79710);
PROVIDE(D_1AD2A0 = __gamedata_start + 0x79720);
PROVIDE(D_1AD2B0 = __gamedata_start + 0x79730);
PROVIDE(D_1AD2B4 = __gamedata_start + 0x79734);
PROVIDE(D_1AD2B8 = __gamedata_start + 0x79738);
PROVIDE(D_1AD2E8 = __gamedata_start + 0x79768);
PROVIDE(D_1AD300 = __gamedata_start + 0x79780);
PROVIDE(g_vendorCaptionFmt = __gamedata_start + 0x797B8);  /* const */
PROVIDE(D_1AD388 = __gamedata_start + 0x79808);
PROVIDE(g_armorTierMessageTextId = __gamedata_start + 0x79808);
PROVIDE(D_1AD564 = __gamedata_start + 0x799E4);
PROVIDE(D_001AD7C4 = __gamedata_start + 0x79C44);
PROVIDE(g_voiceTrigger = __gamedata_start + 0x79C44);
PROVIDE(D_001AD7C8 = __gamedata_start + 0x79C48);
PROVIDE(g_voiceTriggerAux = __gamedata_start + 0x79C48);
PROVIDE(g_pHeroGroundMoby = __gamedata_start + 0x79C4C);
PROVIDE(g_heroZoom = __gamedata_start + 0x79C58);
PROVIDE(D_001AD7DC = __gamedata_start + 0x79C5C);
PROVIDE(D_001AD7E0 = __gamedata_start + 0x79C60);
PROVIDE(D_001AD7E4 = __gamedata_start + 0x79C64);
PROVIDE(D_1AD7E8 = __gamedata_start + 0x79C68);
PROVIDE(D_1AD7EC = __gamedata_start + 0x79C6C);
PROVIDE(D_1AD7F0 = __gamedata_start + 0x79C70);
PROVIDE(D_1AD7F4 = __gamedata_start + 0x79C74);
PROVIDE(D_1AD7F8 = __gamedata_start + 0x79C78);
PROVIDE(D_1AD7FC = __gamedata_start + 0x79C7C);
PROVIDE(D_1AD890 = __gamedata_start + 0x79D10);
PROVIDE(D_1AD8A8 = __gamedata_start + 0x79D28);
PROVIDE(D_1AD8C8 = __gamedata_start + 0x79D48);
PROVIDE(D_1AD8E8 = __gamedata_start + 0x79D68);
PROVIDE(D_1AD908 = __gamedata_start + 0x79D88);
PROVIDE(D_1AD968 = __gamedata_start + 0x79DE8);
PROVIDE(D_1AD988 = __gamedata_start + 0x79E08);
PROVIDE(D_1AD9A8 = __gamedata_start + 0x79E28);
PROVIDE(D_1AD9C8 = __gamedata_start + 0x79E48);
PROVIDE(g_guiTintEnabled = __gamedata_start + 0x79E4C);
PROVIDE(g_guiTintRgb = __gamedata_start + 0x79E50);
PROVIDE(g_GuiListRowVtable = __gamedata_start + 0x79E58);
PROVIDE(D_1AD9F8 = __gamedata_start + 0x79E78);
PROVIDE(D_1ADA18 = __gamedata_start + 0x79E98);
PROVIDE(D_1ADA38 = __gamedata_start + 0x79EB8);
PROVIDE(g_GuiElementVtable = __gamedata_start + 0x79ED8);
PROVIDE(D_1ADA78 = __gamedata_start + 0x79EF8);
PROVIDE(D_1ADA98 = __gamedata_start + 0x79F18);
PROVIDE(D_1ADAC0 = __gamedata_start + 0x79F40);
PROVIDE(D_1ADAD8 = __gamedata_start + 0x79F58);
PROVIDE(D_1ADAF0 = __gamedata_start + 0x79F70);
PROVIDE(D_1ADAF8 = __gamedata_start + 0x79F78);
PROVIDE(D_1ADB08 = __gamedata_start + 0x79F88);
PROVIDE(D_1ADB14 = __gamedata_start + 0x79F94);
PROVIDE(D_1ADB1C = __gamedata_start + 0x79F9C);
PROVIDE(D_1ADB20 = __gamedata_start + 0x79FA0);
PROVIDE(D_1ADB30 = __gamedata_start + 0x79FB0);
PROVIDE(D_1ADB38 = __gamedata_start + 0x79FB8);
PROVIDE(D_1ADB48 = __gamedata_start + 0x79FC8);
PROVIDE(D_1ADB58 = __gamedata_start + 0x79FD8);
PROVIDE(D_1ADB70 = __gamedata_start + 0x79FF0);
PROVIDE(D_1ADB90 = __gamedata_start + 0x7A010);
PROVIDE(D_1ADB98 = __gamedata_start + 0x7A018);
PROVIDE(D_1ADBA8 = __gamedata_start + 0x7A028);
PROVIDE(D_1ADBE8 = __gamedata_start + 0x7A068);
PROVIDE(D_1ADBF0 = __gamedata_start + 0x7A070);
PROVIDE(D_1ADBF8 = __gamedata_start + 0x7A078);
PROVIDE(D_1ADC00 = __gamedata_start + 0x7A080);
PROVIDE(D_1ADC08 = __gamedata_start + 0x7A088);
PROVIDE(D_1ADC10 = __gamedata_start + 0x7A090);
PROVIDE(D_1ADC18 = __gamedata_start + 0x7A098);
PROVIDE(D_1ADC28 = __gamedata_start + 0x7A0A8);
PROVIDE(D_1ADC38 = __gamedata_start + 0x7A0B8);
PROVIDE(D_1ADC40 = __gamedata_start + 0x7A0C0);
PROVIDE(D_1ADC48 = __gamedata_start + 0x7A0C8);
PROVIDE(D_1ADC50 = __gamedata_start + 0x7A0D0);
PROVIDE(D_1ADC60 = __gamedata_start + 0x7A0E0);
PROVIDE(D_1ADC68 = __gamedata_start + 0x7A0E8);
PROVIDE(D_1ADC6C = __gamedata_start + 0x7A0EC);
PROVIDE(D_1ADC70 = __gamedata_start + 0x7A0F0);
PROVIDE(D_1ADC78 = __gamedata_start + 0x7A0F8);
PROVIDE(D_1ADC80 = __gamedata_start + 0x7A100);
PROVIDE(D_1ADC90 = __gamedata_start + 0x7A110);
PROVIDE(D_1ADC98 = __gamedata_start + 0x7A118);
PROVIDE(D_1ADCA0 = __gamedata_start + 0x7A120);
PROVIDE(D_1ADCA8 = __gamedata_start + 0x7A128);
PROVIDE(D_1ADCB8 = __gamedata_start + 0x7A138);
PROVIDE(D_1ADCC0 = __gamedata_start + 0x7A140);
PROVIDE(D_1ADCC8 = __gamedata_start + 0x7A148);
PROVIDE(D_1ADCD0 = __gamedata_start + 0x7A150);
PROVIDE(D_1ADCD8 = __gamedata_start + 0x7A158);
PROVIDE(D_1ADCDC = __gamedata_start + 0x7A15C);
PROVIDE(D_1ADCE0 = __gamedata_start + 0x7A160);
PROVIDE(D_1ADCE4 = __gamedata_start + 0x7A164);
PROVIDE(D_1ADCE8 = __gamedata_start + 0x7A168);
PROVIDE(D_1ADCEC = __gamedata_start + 0x7A16C);
PROVIDE(D_1ADCF0 = __gamedata_start + 0x7A170);
PROVIDE(D_1ADCF8 = __gamedata_start + 0x7A178);
PROVIDE(D_1ADCFC = __gamedata_start + 0x7A17C);
PROVIDE(D_1ADD00 = __gamedata_start + 0x7A180);
PROVIDE(D_1ADD04 = __gamedata_start + 0x7A184);
PROVIDE(D_1ADD08 = __gamedata_start + 0x7A188);
PROVIDE(D_1ADD18 = __gamedata_start + 0x7A198);
PROVIDE(D_1ADD30 = __gamedata_start + 0x7A1B0);
PROVIDE(D_1ADD38 = __gamedata_start + 0x7A1B8);
PROVIDE(D_1ADD40 = __gamedata_start + 0x7A1C0);
PROVIDE(D_1ADD48 = __gamedata_start + 0x7A1C8);
PROVIDE(D_1ADD50 = __gamedata_start + 0x7A1D0);
PROVIDE(D_1ADD98 = __gamedata_start + 0x7A218);
PROVIDE(D_1ADDA8 = __gamedata_start + 0x7A228);
PROVIDE(D_1ADDB0 = __gamedata_start + 0x7A230);
PROVIDE(D_1ADDB8 = __gamedata_start + 0x7A238);
PROVIDE(D_1ADDC8 = __gamedata_start + 0x7A248);
PROVIDE(D_1ADDD8 = __gamedata_start + 0x7A258);
PROVIDE(D_1ADDDC = __gamedata_start + 0x7A25C);
PROVIDE(D_1ADDE0 = __gamedata_start + 0x7A260);
PROVIDE(D_1ADDE4 = __gamedata_start + 0x7A264);
PROVIDE(D_1ADDE8 = __gamedata_start + 0x7A268);
PROVIDE(D_1ADDEC = __gamedata_start + 0x7A26C);
PROVIDE(D_1ADDF0 = __gamedata_start + 0x7A270);
PROVIDE(D_1ADDF4 = __gamedata_start + 0x7A274);
PROVIDE(D_1ADDF8 = __gamedata_start + 0x7A278);
PROVIDE(D_1ADE00 = __gamedata_start + 0x7A280);
PROVIDE(D_1ADE08 = __gamedata_start + 0x7A288);
PROVIDE(D_1ADE10 = __gamedata_start + 0x7A290);
PROVIDE(D_1ADE20 = __gamedata_start + 0x7A2A0);
PROVIDE(D_1ADE30 = __gamedata_start + 0x7A2B0);
PROVIDE(D_1ADE34 = __gamedata_start + 0x7A2B4);
PROVIDE(D_1ADE38 = __gamedata_start + 0x7A2B8);
PROVIDE(D_1ADE3C = __gamedata_start + 0x7A2BC);
PROVIDE(D_1ADE40 = __gamedata_start + 0x7A2C0);
PROVIDE(D_1ADE48 = __gamedata_start + 0x7A2C8);
PROVIDE(D_1ADE50 = __gamedata_start + 0x7A2D0);
PROVIDE(D_1ADE60 = __gamedata_start + 0x7A2E0);
PROVIDE(D_1ADE70 = __gamedata_start + 0x7A2F0);
PROVIDE(D_1ADE80 = __gamedata_start + 0x7A300);
PROVIDE(D_1ADE90 = __gamedata_start + 0x7A310);
PROVIDE(D_1ADEA0 = __gamedata_start + 0x7A320);
PROVIDE(D_1ADEB0 = __gamedata_start + 0x7A330);
PROVIDE(D_1ADEC8 = __gamedata_start + 0x7A348);
PROVIDE(D_1ADED8 = __gamedata_start + 0x7A358);
PROVIDE(D_1ADEE8 = __gamedata_start + 0x7A368);
PROVIDE(D_1ADEF0 = __gamedata_start + 0x7A370);
PROVIDE(D_1ADEF8 = __gamedata_start + 0x7A378);
PROVIDE(D_1ADF00 = __gamedata_start + 0x7A380);
PROVIDE(D_1ADF04 = __gamedata_start + 0x7A384);
PROVIDE(D_1ADF08 = __gamedata_start + 0x7A388);
PROVIDE(D_1ADF0C = __gamedata_start + 0x7A38C);
PROVIDE(D_1ADF10 = __gamedata_start + 0x7A390);
PROVIDE(D_1ADF14 = __gamedata_start + 0x7A394);
PROVIDE(D_1ADF18 = __gamedata_start + 0x7A398);
PROVIDE(D_1ADF1C = __gamedata_start + 0x7A39C);
PROVIDE(D_1ADF20 = __gamedata_start + 0x7A3A0);
PROVIDE(D_1ADF24 = __gamedata_start + 0x7A3A4);
PROVIDE(D_1ADF28 = __gamedata_start + 0x7A3A8);
PROVIDE(D_1ADF2C = __gamedata_start + 0x7A3AC);
PROVIDE(D_1ADF30 = __gamedata_start + 0x7A3B0);
PROVIDE(D_1ADF34 = __gamedata_start + 0x7A3B4);
PROVIDE(D_1ADF38 = __gamedata_start + 0x7A3B8);
PROVIDE(D_1ADF3C = __gamedata_start + 0x7A3BC);
PROVIDE(D_1ADF40 = __gamedata_start + 0x7A3C0);
PROVIDE(D_1ADF44 = __gamedata_start + 0x7A3C4);
PROVIDE(D_1ADF48 = __gamedata_start + 0x7A3C8);
PROVIDE(D_1ADF4C = __gamedata_start + 0x7A3CC);
PROVIDE(D_1ADF50 = __gamedata_start + 0x7A3D0);
PROVIDE(D_1ADF54 = __gamedata_start + 0x7A3D4);
PROVIDE(D_1ADF68 = __gamedata_start + 0x7A3E8);
PROVIDE(D_1ADF70 = __gamedata_start + 0x7A3F0);
PROVIDE(D_1ADF78 = __gamedata_start + 0x7A3F8);
PROVIDE(D_1ADF80 = __gamedata_start + 0x7A400);
PROVIDE(D_1ADF88 = __gamedata_start + 0x7A408);
PROVIDE(D_1ADF90 = __gamedata_start + 0x7A410);
PROVIDE(D_1ADF98 = __gamedata_start + 0x7A418);
PROVIDE(D_1ADFA0 = __gamedata_start + 0x7A420);
PROVIDE(D_1ADFA8 = __gamedata_start + 0x7A428);
PROVIDE(D_1ADFB0 = __gamedata_start + 0x7A430);
PROVIDE(D_1ADFB8 = __gamedata_start + 0x7A438);
PROVIDE(D_1ADFC8 = __gamedata_start + 0x7A448);
PROVIDE(D_1ADFD8 = __gamedata_start + 0x7A458);
PROVIDE(D_1ADFE8 = __gamedata_start + 0x7A468);
PROVIDE(D_1ADFF8 = __gamedata_start + 0x7A478);
PROVIDE(D_1AE008 = __gamedata_start + 0x7A488);
PROVIDE(D_1AE018 = __gamedata_start + 0x7A498);
PROVIDE(D_1AE020 = __gamedata_start + 0x7A4A0);
PROVIDE(D_1AE028 = __gamedata_start + 0x7A4A8);
PROVIDE(D_1AE030 = __gamedata_start + 0x7A4B0);
PROVIDE(D_1AE038 = __gamedata_start + 0x7A4B8);
PROVIDE(D_1AE040 = __gamedata_start + 0x7A4C0);
PROVIDE(D_1AE048 = __gamedata_start + 0x7A4C8);
PROVIDE(D_1AE050 = __gamedata_start + 0x7A4D0);
PROVIDE(D_1AE058 = __gamedata_start + 0x7A4D8);
PROVIDE(D_1AE060 = __gamedata_start + 0x7A4E0);
PROVIDE(D_1AE068 = __gamedata_start + 0x7A4E8);
PROVIDE(D_1AE070 = __gamedata_start + 0x7A4F0);
PROVIDE(D_1AE078 = __gamedata_start + 0x7A4F8);
PROVIDE(D_1AE080 = __gamedata_start + 0x7A500);
PROVIDE(D_1AE088 = __gamedata_start + 0x7A508);
PROVIDE(D_1AE098 = __gamedata_start + 0x7A518);
PROVIDE(D_1AE0A0 = __gamedata_start + 0x7A520);
PROVIDE(D_1AE0B0 = __gamedata_start + 0x7A530);
PROVIDE(D_1AE0B4 = __gamedata_start + 0x7A534);
PROVIDE(D_1AE0B8 = __gamedata_start + 0x7A538);
PROVIDE(D_1AE0C0 = __gamedata_start + 0x7A540);
PROVIDE(D_1AE0C4 = __gamedata_start + 0x7A544);
PROVIDE(D_1AE0C8 = __gamedata_start + 0x7A548);
PROVIDE(D_1AE0CC = __gamedata_start + 0x7A54C);
PROVIDE(D_1AE0D0 = __gamedata_start + 0x7A550);
PROVIDE(D_1AE0D4 = __gamedata_start + 0x7A554);
PROVIDE(D_1AE0D8 = __gamedata_start + 0x7A558);
PROVIDE(D_1AE0DC = __gamedata_start + 0x7A55C);
PROVIDE(D_1AE0E0 = __gamedata_start + 0x7A560);
PROVIDE(D_1AE0E4 = __gamedata_start + 0x7A564);
PROVIDE(D_1AE0E8 = __gamedata_start + 0x7A568);
PROVIDE(D_1AE0EC = __gamedata_start + 0x7A56C);
PROVIDE(D_1AE0F0 = __gamedata_start + 0x7A570);
PROVIDE(D_1AE0F4 = __gamedata_start + 0x7A574);
PROVIDE(D_1AE0F8 = __gamedata_start + 0x7A578);
PROVIDE(D_1AE0FC = __gamedata_start + 0x7A57C);
PROVIDE(D_1AE100 = __gamedata_start + 0x7A580);
PROVIDE(D_1AE104 = __gamedata_start + 0x7A584);
PROVIDE(D_1AE108 = __gamedata_start + 0x7A588);
PROVIDE(D_1AE10C = __gamedata_start + 0x7A58C);
PROVIDE(D_1AE110 = __gamedata_start + 0x7A590);
PROVIDE(D_1AE150 = __gamedata_start + 0x7A5D0);
PROVIDE(D_1AE154 = __gamedata_start + 0x7A5D4);
PROVIDE(D_1AE158 = __gamedata_start + 0x7A5D8);
PROVIDE(D_1AE160 = __gamedata_start + 0x7A5E0);
PROVIDE(D_1AE164 = __gamedata_start + 0x7A5E4);
PROVIDE(D_1AE168 = __gamedata_start + 0x7A5E8);
PROVIDE(D_1AE16C = __gamedata_start + 0x7A5EC);
PROVIDE(D_1AE170 = __gamedata_start + 0x7A5F0);
PROVIDE(D_1AE174 = __gamedata_start + 0x7A5F4);
PROVIDE(D_1AE178 = __gamedata_start + 0x7A5F8);
PROVIDE(D_1AE17C = __gamedata_start + 0x7A5FC);
PROVIDE(D_1AE180 = __gamedata_start + 0x7A600);
PROVIDE(D_1AE198 = __gamedata_start + 0x7A618);
PROVIDE(D_1AE19C = __gamedata_start + 0x7A61C);
PROVIDE(D_1AE1A0 = __gamedata_start + 0x7A620);
PROVIDE(D_1AE1A4 = __gamedata_start + 0x7A624);
PROVIDE(D_1AE1D0 = __gamedata_start + 0x7A650);
PROVIDE(D_1AE1D4 = __gamedata_start + 0x7A654);
PROVIDE(D_1AE1D8 = __gamedata_start + 0x7A658);
PROVIDE(D_1AE1DC = __gamedata_start + 0x7A65C);
PROVIDE(D_1AE1E0 = __gamedata_start + 0x7A660);
PROVIDE(D_1AE1E4 = __gamedata_start + 0x7A664);
PROVIDE(D_1AE1E8 = __gamedata_start + 0x7A668);
PROVIDE(D_1AE1EC = __gamedata_start + 0x7A66C);
PROVIDE(D_1AE1F0 = __gamedata_start + 0x7A670);
PROVIDE(D_1AE1F4 = __gamedata_start + 0x7A674);
PROVIDE(D_1AE1F8 = __gamedata_start + 0x7A678);
PROVIDE(D_1AE200 = __gamedata_start + 0x7A680);
PROVIDE(D_1AE204 = __gamedata_start + 0x7A684);
PROVIDE(D_1AE208 = __gamedata_start + 0x7A688);
PROVIDE(D_1AE20C = __gamedata_start + 0x7A68C);
PROVIDE(D_1AE210 = __gamedata_start + 0x7A690);
PROVIDE(D_1AE214 = __gamedata_start + 0x7A694);
PROVIDE(D_1AE218 = __gamedata_start + 0x7A698);
PROVIDE(D_1AE21C = __gamedata_start + 0x7A69C);
PROVIDE(D_1AE220 = __gamedata_start + 0x7A6A0);
PROVIDE(D_1AE224 = __gamedata_start + 0x7A6A4);
PROVIDE(D_1AE228 = __gamedata_start + 0x7A6A8);
PROVIDE(D_1AE238 = __gamedata_start + 0x7A6B8);
PROVIDE(D_1AE248 = __gamedata_start + 0x7A6C8);
PROVIDE(D_1AE258 = __gamedata_start + 0x7A6D8);
PROVIDE(D_1AE25C = __gamedata_start + 0x7A6DC);
PROVIDE(D_1AE260 = __gamedata_start + 0x7A6E0);
PROVIDE(D_1AE264 = __gamedata_start + 0x7A6E4);
PROVIDE(D_1AE268 = __gamedata_start + 0x7A6E8);
PROVIDE(D_1AE26C = __gamedata_start + 0x7A6EC);
PROVIDE(D_1AE270 = __gamedata_start + 0x7A6F0);
PROVIDE(D_1AE274 = __gamedata_start + 0x7A6F4);
PROVIDE(D_1AE278 = __gamedata_start + 0x7A6F8);
PROVIDE(D_1AE27C = __gamedata_start + 0x7A6FC);
PROVIDE(D_1AE280 = __gamedata_start + 0x7A700);
PROVIDE(D_1AE288 = __gamedata_start + 0x7A708);
PROVIDE(D_1AE28C = __gamedata_start + 0x7A70C);
PROVIDE(D_1AE290 = __gamedata_start + 0x7A710);
PROVIDE(D_1AE294 = __gamedata_start + 0x7A714);
PROVIDE(D_1AE298 = __gamedata_start + 0x7A718);
PROVIDE(D_1AE29C = __gamedata_start + 0x7A71C);
PROVIDE(D_1AE2A0 = __gamedata_start + 0x7A720);
PROVIDE(D_1AE2A4 = __gamedata_start + 0x7A724);
PROVIDE(D_1AE2A8 = __gamedata_start + 0x7A728);
PROVIDE(D_1AE2AC = __gamedata_start + 0x7A72C);
PROVIDE(D_1AE2B0 = __gamedata_start + 0x7A730);
PROVIDE(D_1AE2B4 = __gamedata_start + 0x7A734);
PROVIDE(D_1AE2D0 = __gamedata_start + 0x7A750);
PROVIDE(D_1AE2F0 = __gamedata_start + 0x7A770);
PROVIDE(D_1AE2F4 = __gamedata_start + 0x7A774);
PROVIDE(D_1AE2F8 = __gamedata_start + 0x7A778);
PROVIDE(D_1AE300 = __gamedata_start + 0x7A780);
PROVIDE(D_1AE308 = __gamedata_start + 0x7A788);
PROVIDE(D_1AE310 = __gamedata_start + 0x7A790);
PROVIDE(D_1AE318 = __gamedata_start + 0x7A798);
PROVIDE(D_1AE320 = __gamedata_start + 0x7A7A0);
PROVIDE(D_1AE324 = __gamedata_start + 0x7A7A4);
PROVIDE(D_1AE328 = __gamedata_start + 0x7A7A8);
PROVIDE(D_1AE330 = __gamedata_start + 0x7A7B0);
PROVIDE(D_1AE338 = __gamedata_start + 0x7A7B8);
PROVIDE(D_1AE340 = __gamedata_start + 0x7A7C0);
PROVIDE(D_1AE348 = __gamedata_start + 0x7A7C8);
PROVIDE(D_1AE350 = __gamedata_start + 0x7A7D0);
PROVIDE(D_1AE354 = __gamedata_start + 0x7A7D4);
PROVIDE(D_1AE358 = __gamedata_start + 0x7A7D8);
PROVIDE(D_1AE360 = __gamedata_start + 0x7A7E0);
PROVIDE(D_1AE368 = __gamedata_start + 0x7A7E8);
PROVIDE(D_1AE370 = __gamedata_start + 0x7A7F0);
PROVIDE(D_1AE378 = __gamedata_start + 0x7A7F8);
PROVIDE(D_1AE380 = __gamedata_start + 0x7A800);
PROVIDE(D_1AE384 = __gamedata_start + 0x7A804);
PROVIDE(D_1AE388 = __gamedata_start + 0x7A808);
PROVIDE(D_1AE390 = __gamedata_start + 0x7A810);
PROVIDE(D_1AE398 = __gamedata_start + 0x7A818);
PROVIDE(D_1AE3A0 = __gamedata_start + 0x7A820);
PROVIDE(D_1AE3A8 = __gamedata_start + 0x7A828);
PROVIDE(D_1AE3B0 = __gamedata_start + 0x7A830);
PROVIDE(D_1AE3C0 = __gamedata_start + 0x7A840);
PROVIDE(D_1AE3D0 = __gamedata_start + 0x7A850);
PROVIDE(D_1AE3D8 = __gamedata_start + 0x7A858);
PROVIDE(D_1AE3DC = __gamedata_start + 0x7A85C);
PROVIDE(D_1AE3E0 = __gamedata_start + 0x7A860);
PROVIDE(D_1AE3E4 = __gamedata_start + 0x7A864);
PROVIDE(D_1AE3E8 = __gamedata_start + 0x7A868);
PROVIDE(D_1AE3EC = __gamedata_start + 0x7A86C);
PROVIDE(D_1AE3F0 = __gamedata_start + 0x7A870);
PROVIDE(D_1AE3F4 = __gamedata_start + 0x7A874);
PROVIDE(D_1AE3F8 = __gamedata_start + 0x7A878);
PROVIDE(D_1AE3FC = __gamedata_start + 0x7A87C);
PROVIDE(D_1AE400 = __gamedata_start + 0x7A880);
PROVIDE(D_1AE404 = __gamedata_start + 0x7A884);
PROVIDE(D_1AE408 = __gamedata_start + 0x7A888);
PROVIDE(D_1AE40C = __gamedata_start + 0x7A88C);
PROVIDE(D_1AE410 = __gamedata_start + 0x7A890);
PROVIDE(D_1AE414 = __gamedata_start + 0x7A894);
PROVIDE(D_1AE418 = __gamedata_start + 0x7A898);
PROVIDE(D_1AE41C = __gamedata_start + 0x7A89C);
PROVIDE(D_1AE420 = __gamedata_start + 0x7A8A0);
PROVIDE(D_1AE424 = __gamedata_start + 0x7A8A4);
PROVIDE(D_1AE428 = __gamedata_start + 0x7A8A8);
PROVIDE(D_1AE42C = __gamedata_start + 0x7A8AC);
PROVIDE(D_1AE430 = __gamedata_start + 0x7A8B0);
PROVIDE(D_1AE438 = __gamedata_start + 0x7A8B8);
PROVIDE(D_1AE440 = __gamedata_start + 0x7A8C0);
PROVIDE(D_1AE448 = __gamedata_start + 0x7A8C8);
PROVIDE(D_1AE450 = __gamedata_start + 0x7A8D0);
PROVIDE(D_1AE458 = __gamedata_start + 0x7A8D8);
PROVIDE(D_1AE45C = __gamedata_start + 0x7A8DC);
PROVIDE(D_1AE460 = __gamedata_start + 0x7A8E0);
PROVIDE(D_1AE468 = __gamedata_start + 0x7A8E8);
PROVIDE(D_1AE470 = __gamedata_start + 0x7A8F0);
PROVIDE(D_1AE478 = __gamedata_start + 0x7A8F8);
PROVIDE(D_1AE480 = __gamedata_start + 0x7A900);
PROVIDE(D_1AE488 = __gamedata_start + 0x7A908);
PROVIDE(D_1AE48C = __gamedata_start + 0x7A90C);
PROVIDE(D_1AE490 = __gamedata_start + 0x7A910);
PROVIDE(D_1AE498 = __gamedata_start + 0x7A918);
PROVIDE(D_1AE4A0 = __gamedata_start + 0x7A920);
PROVIDE(D_1AE4A8 = __gamedata_start + 0x7A928);
PROVIDE(D_1AE4B0 = __gamedata_start + 0x7A930);
PROVIDE(D_1AE4B8 = __gamedata_start + 0x7A938);
PROVIDE(D_1AE4C0 = __gamedata_start + 0x7A940);
PROVIDE(D_1AE4D0 = __gamedata_start + 0x7A950);
PROVIDE(D_1AE4D8 = __gamedata_start + 0x7A958);
PROVIDE(D_1AE4E0 = __gamedata_start + 0x7A960);
PROVIDE(D_1AE4E8 = __gamedata_start + 0x7A968);
PROVIDE(D_1AE4F0 = __gamedata_start + 0x7A970);
PROVIDE(D_1AE4F8 = __gamedata_start + 0x7A978);
PROVIDE(D_1AE500 = __gamedata_start + 0x7A980);
PROVIDE(D_1AE510 = __gamedata_start + 0x7A990);
PROVIDE(D_1AE518 = __gamedata_start + 0x7A998);
PROVIDE(D_1AE51C = __gamedata_start + 0x7A99C);
PROVIDE(D_1AE520 = __gamedata_start + 0x7A9A0);
PROVIDE(D_1AE524 = __gamedata_start + 0x7A9A4);
PROVIDE(D_1AE528 = __gamedata_start + 0x7A9A8);
PROVIDE(D_1AE52C = __gamedata_start + 0x7A9AC);
PROVIDE(D_1AE530 = __gamedata_start + 0x7A9B0);
PROVIDE(D_1AE538 = __gamedata_start + 0x7A9B8);
PROVIDE(D_1AE53C = __gamedata_start + 0x7A9BC);
PROVIDE(D_1AE540 = __gamedata_start + 0x7A9C0);
PROVIDE(D_1AE544 = __gamedata_start + 0x7A9C4);
PROVIDE(D_1AE548 = __gamedata_start + 0x7A9C8);
PROVIDE(D_1AE54C = __gamedata_start + 0x7A9CC);
PROVIDE(D_1AE550 = __gamedata_start + 0x7A9D0);
PROVIDE(D_1AE554 = __gamedata_start + 0x7A9D4);
PROVIDE(D_1AE558 = __gamedata_start + 0x7A9D8);
PROVIDE(D_1AE55C = __gamedata_start + 0x7A9DC);
PROVIDE(D_1AE560 = __gamedata_start + 0x7A9E0);
PROVIDE(D_1AE564 = __gamedata_start + 0x7A9E4);
PROVIDE(D_1AE568 = __gamedata_start + 0x7A9E8);
PROVIDE(D_1AE570 = __gamedata_start + 0x7A9F0);
PROVIDE(D_1AE578 = __gamedata_start + 0x7A9F8);
PROVIDE(D_1AE588 = __gamedata_start + 0x7AA08);
PROVIDE(D_1AE5E8 = __gamedata_start + 0x7AA68);
PROVIDE(D_1AE5F8 = __gamedata_start + 0x7AA78);
PROVIDE(D_1AE608 = __gamedata_start + 0x7AA88);
PROVIDE(D_1AE618 = __gamedata_start + 0x7AA98);
PROVIDE(D_1AE6C8 = __gamedata_start + 0x7AB48);
PROVIDE(D_1AE6D8 = __gamedata_start + 0x7AB58);
PROVIDE(D_1AE6E4 = __gamedata_start + 0x7AB64);
PROVIDE(D_1AE6E8 = __gamedata_start + 0x7AB68);
PROVIDE(D_1AE6EC = __gamedata_start + 0x7AB6C);
PROVIDE(D_1AE6F0 = __gamedata_start + 0x7AB70);
PROVIDE(D_1AE6F4 = __gamedata_start + 0x7AB74);
PROVIDE(D_1AE6F8 = __gamedata_start + 0x7AB78);
PROVIDE(D_1AE700 = __gamedata_start + 0x7AB80);
PROVIDE(D_1AE704 = __gamedata_start + 0x7AB84);
PROVIDE(D_1AE708 = __gamedata_start + 0x7AB88);
PROVIDE(D_1AE70C = __gamedata_start + 0x7AB8C);
PROVIDE(D_1AE710 = __gamedata_start + 0x7AB90);
PROVIDE(D_1AE714 = __gamedata_start + 0x7AB94);
PROVIDE(D_1AE740 = __gamedata_start + 0x7ABC0);
PROVIDE(D_1AE744 = __gamedata_start + 0x7ABC4);
PROVIDE(D_1AE748 = __gamedata_start + 0x7ABC8);
PROVIDE(D_1AE74C = __gamedata_start + 0x7ABCC);
PROVIDE(D_1AE750 = __gamedata_start + 0x7ABD0);
PROVIDE(D_1AE754 = __gamedata_start + 0x7ABD4);
PROVIDE(D_1AE758 = __gamedata_start + 0x7ABD8);  /* const */
PROVIDE(D_1AE770 = __gamedata_start + 0x7ABF0);  /* const */
PROVIDE(D_1AE788 = __gamedata_start + 0x7AC08);
PROVIDE(D_1AE78C = __gamedata_start + 0x7AC0C);
PROVIDE(D_1AE790 = __gamedata_start + 0x7AC10);
PROVIDE(D_1AE794 = __gamedata_start + 0x7AC14);
PROVIDE(D_1AE798 = __gamedata_start + 0x7AC18);
PROVIDE(D_1AE7A0 = __gamedata_start + 0x7AC20);
PROVIDE(D_1AE7D8 = __gamedata_start + 0x7AC58);  /* const */
PROVIDE(D_1AE7E8 = __gamedata_start + 0x7AC68);  /* const */
PROVIDE(D_1AE800 = __gamedata_start + 0x7AC80);
PROVIDE(D_1AE818 = __gamedata_start + 0x7AC98);
PROVIDE(D_1AE820 = __gamedata_start + 0x7ACA0);  /* const */
PROVIDE(D_1AE838 = __gamedata_start + 0x7ACB8);  /* const */
PROVIDE(D_1AE860 = __gamedata_start + 0x7ACE0);
PROVIDE(D_001AEFF0 = __gamedata_start + 0x7B470);
PROVIDE(D_001B1300 = __gamedata_start + 0x7D780);
PROVIDE(g_cameraCallbacks = __gamedata_start + 0x7D8C0);
PROVIDE(g_cameraCallbackCount = __gamedata_start + 0x7D900);
PROVIDE(g_renderLayerMask = __gamedata_start + 0x7D994);
PROVIDE(D_001B1518 = __gamedata_start + 0x7D998);
PROVIDE(D_1B1518 = __gamedata_start + 0x7D998);
PROVIDE(g_pReservedMoby0 = __gamedata_start + 0x7D99C);
PROVIDE(g_screenFadeBlack = __gamedata_start + 0x7D9A0);
PROVIDE(g_screenFadeWhite = __gamedata_start + 0x7D9A4);
PROVIDE(g_2dBatchOpenTag = __gamedata_start + 0x7D9F4);
PROVIDE(g_2dBatchCloseTag = __gamedata_start + 0x7D9F8);
PROVIDE(g_texUploadCount = __gamedata_start + 0x7D9FC);
PROVIDE(g_uiTextureCount = __gamedata_start + 0x7DA00);
PROVIDE(g_uiTextureDataBase = __gamedata_start + 0x7DA04);
PROVIDE(g_fxHooksPreCount = __gamedata_start + 0x7DA08);
PROVIDE(g_fxHooksPostCount = __gamedata_start + 0x7DA0C);
PROVIDE(g_drawHooksAfterTiesCount = __gamedata_start + 0x7DA10);
PROVIDE(g_drawHooksAfterShrubsCount = __gamedata_start + 0x7DA14);
PROVIDE(g_fxHooksLateFuncs = __gamedata_start + 0x7DA18);
PROVIDE(g_fxHooksLateArgs = __gamedata_start + 0x7DA28);
PROVIDE(g_fxHooksLateCount = __gamedata_start + 0x7DA38);
PROVIDE(g_blobShadowCount = __gamedata_start + 0x7DA3C);
PROVIDE(g_textColorCodeEnabled = __gamedata_start + 0x7DA68);
PROVIDE(g_bInWrappedTextBox = __gamedata_start + 0x7DA6C);
PROVIDE(g_nLevelExitDestination = __gamedata_start + 0x7DA80);
PROVIDE(g_gameTime = __gamedata_start + 0x7DA88);
PROVIDE(g_frameGpuTime = __gamedata_start + 0x7DA90);
PROVIDE(g_activeVu1Program = __gamedata_start + 0x7DA9C);
PROVIDE(g_globalSoundDefsPtr = __gamedata_start + 0x7DAAC);
PROVIDE(g_renderTaskList = __gamedata_start + 0x7DAB0);
PROVIDE(g_renderTaskWorkBuf = __gamedata_start + 0x7DAB4);
PROVIDE(g_occlusionOverrideMode = __gamedata_start + 0x7DB0C);
PROVIDE(g_occlusionMode = __gamedata_start + 0x7DB10);
PROVIDE(g_pLastOcclusionMask = __gamedata_start + 0x7DB18);
PROVIDE(g_pActiveNanotechOrb = __gamedata_start + 0x7DBAC);
PROVIDE(g_mobyTargetGroupLists = __gamedata_start + 0x7DBBC);
PROVIDE(g_mobyTargetGroupDescs = __gamedata_start + 0x7DBC0);
PROVIDE(D_001B1750 = __gamedata_start + 0x7DBD0);
PROVIDE(g_pActiveTextTable = __gamedata_start + 0x7DC40);
PROVIDE(g_debugMallocCursor = __gamedata_start + 0x7DC80);
PROVIDE(g_debugMallocEnd = __gamedata_start + 0x7DC84);
PROVIDE(g_pHudAssetHeader = __gamedata_start + 0x7DC88);
PROVIDE(g_hudIconMap = __gamedata_start + 0x7DC90);
PROVIDE(g_pHudIconMap = __gamedata_start + 0x7DC90);
PROVIDE(g_hudTextureSlots = __gamedata_start + 0x7DC94);
PROVIDE(g_pHudTextureSlots = __gamedata_start + 0x7DC94);
PROVIDE(g_hudClutSlots = __gamedata_start + 0x7DC98);
PROVIDE(g_hudMobyTableBase = __gamedata_start + 0x7DCAC);
PROVIDE(g_hudMobySpawnStart = __gamedata_start + 0x7DCB0);
PROVIDE(g_hudMobyTableEnd = __gamedata_start + 0x7DCE0);
PROVIDE(g_hudMobyAuxBlockBase = __gamedata_start + 0x7DCE4);
PROVIDE(D_1B1878 = __gamedata_start + 0x7DCF8);
PROVIDE(D_1B187C = __gamedata_start + 0x7DCFC);
PROVIDE(g_nBoltCounterDisplayed = __gamedata_start + 0x7DD48);
PROVIDE(g_pSkyShellSpinRates = __gamedata_start + 0x7DD90);
PROVIDE(g_altTexRegs2 = __gamedata_start + 0x7DDB0);
PROVIDE(g_altTexRegs3 = __gamedata_start + 0x7DDC8);
PROVIDE(g_rainHeightmapOrigin = __gamedata_start + 0x7DDE0);
PROVIDE(g_rainHeightmapBaseHeight = __gamedata_start + 0x7DDE8);
PROVIDE(g_rainHeightmapCellW = __gamedata_start + 0x7DE10);
PROVIDE(g_rainHeightmapCellH = __gamedata_start + 0x7DE14);
PROVIDE(g_rainHeightmapHeightScale = __gamedata_start + 0x7DE18);
PROVIDE(g_pRainHeightmap = __gamedata_start + 0x7DE20);
PROVIDE(g_mobySpawnCredit = __gamedata_start + 0x7DE80);
PROVIDE(g_proceduralAnimSlotOwners = __gamedata_start + 0x7DEC0);
PROVIDE(g_proceduralAnimSlotTimer = __gamedata_start + 0x7DF00);
PROVIDE(g_mobyClassCount = __gamedata_start + 0x7DF40);
PROVIDE(g_mobyClassCountNoHeader = __gamedata_start + 0x7DF44);
PROVIDE(g_mobySegmentOpenTag = __gamedata_start + 0x7DF50);
PROVIDE(g_mobyVuChainCursor = __gamedata_start + 0x7DF58);
PROVIDE(g_mobyTableBase = __gamedata_start + 0x7DF5C);
PROVIDE(g_mobySpawnStart = __gamedata_start + 0x7DF60);
PROVIDE(g_mobyTableEnd = __gamedata_start + 0x7DF64);
PROVIDE(g_activeMobyChainHead = __gamedata_start + 0x7DF68);
PROVIDE(g_mobyAuxBlockBase = __gamedata_start + 0x7DF6C);
PROVIDE(g_mobyGroupCount = __gamedata_start + 0x7DF78);
PROVIDE(g_mobyGlowCount = __gamedata_start + 0x7DF7C);
PROVIDE(g_deferredSegment2Tag = __gamedata_start + 0x7DF80);
PROVIDE(g_pMobyGroupIterCursor = __gamedata_start + 0x7E138);
PROVIDE(g_mobyGroupIterSlot = __gamedata_start + 0x7E13C);
PROVIDE(g_pMobyGroupIterMoby = __gamedata_start + 0x7E140);
PROVIDE(g_gameStateStack = __gamedata_start + 0x7E150);
PROVIDE(g_particleFarFadeMax = __gamedata_start + 0x7E1A0);
PROVIDE(g_particleTexCount = __gamedata_start + 0x7E1A4);
PROVIDE(D_001B1E90 = __gamedata_start + 0x7E310);
PROVIDE(D_001B1FA8 = __gamedata_start + 0x7E428);
PROVIDE(g_pShrubInstanceArray = __gamedata_start + 0x7E498);
PROVIDE(g_pShrubSegmentOpenTag = __gamedata_start + 0x7E4B4);
PROVIDE(g_shrubVramPeak = __gamedata_start + 0x7E4BC);
PROVIDE(g_pSkyData = __gamedata_start + 0x7E4C0);
PROVIDE(g_pSkySegmentOpenTag = __gamedata_start + 0x7E4E0);
PROVIDE(g_pSkySegmentCloseTag = __gamedata_start + 0x7E4E4);
PROVIDE(g_skyShellMatrix = __gamedata_start + 0x7E4F0);
PROVIDE(g_pTfragArray = __gamedata_start + 0x7E570);
PROVIDE(g_pTfragSegmentOpenTag = __gamedata_start + 0x7E59C);
PROVIDE(g_tfragVramPeak = __gamedata_start + 0x7E5A4);
PROVIDE(g_vramSlotTableStart = __gamedata_start + 0x7E5B4);
PROVIDE(g_vramSlotTableEnd = __gamedata_start + 0x7E5B8);
PROVIDE(g_pTieMatrixArray = __gamedata_start + 0x7E5BC);
PROVIDE(g_tieVramLruHead = __gamedata_start + 0x7E5E0);
PROVIDE(g_tieVramLruTail = __gamedata_start + 0x7E5E4);
PROVIDE(g_tieVramLruSize = __gamedata_start + 0x7E5E8);
PROVIDE(g_cinematicSceneParams = __gamedata_start + 0x7E608);
PROVIDE(g_cinematicFmvSize = __gamedata_start + 0x7E60C);
PROVIDE(g_cinematicReelEntry = __gamedata_start + 0x7E610);
PROVIDE(g_cinematicLanguage = __gamedata_start + 0x7E614);
PROVIDE(g_cinematicFmvFlag = __gamedata_start + 0x7E618);
PROVIDE(g_cinematicResumeVoiceId = __gamedata_start + 0x7E61C);
PROVIDE(g_vendorQtyRepeatTimers = __gamedata_start + 0x7E638);
PROVIDE(g_nVendorBuyQuantity = __gamedata_start + 0x7E648);
PROVIDE(g_frameArenaBase = __gamedata_start + 0x7E6A0);
PROVIDE(g_frameDmaCursor = __gamedata_start + 0x7E6A8);
PROVIDE(g_pFrameDmaCursor = __gamedata_start + 0x7E6A8);
PROVIDE(g_sceneArenaCursor = __gamedata_start + 0x7E6B0);
PROVIDE(g_frameArenaFlip = __gamedata_start + 0x7E6B4);
PROVIDE(g_pWaterWaveGrids = __gamedata_start + 0x7E6D0);
PROVIDE(g_bWaterWavesActive = __gamedata_start + 0x7E6D8);
PROVIDE(g_bWaterPoolActive = __gamedata_start + 0x7E6DC);
PROVIDE(g_waterPool = __gamedata_start + 0x7E6E0);
PROVIDE(g_gadgetDisplay = __gamedata_start + 0x7E710);
PROVIDE(g_swapGadgetItemIndex = __gamedata_start + 0x7E71A);
PROVIDE(D_001B2320 = __gamedata_start + 0x7E7A0);
PROVIDE(D_001B2324 = __gamedata_start + 0x7E7A4);
PROVIDE(D_1B2328 = __gamedata_start + 0x7E7A8);
PROVIDE(g_pFmvGsBase = __gamedata_start + 0x7E7C8);
PROVIDE(g_pFmvArenaBase = __gamedata_start + 0x7E7CC);
PROVIDE(g_fmvThreadId = __gamedata_start + 0x7E7D0);
PROVIDE(D_1B2354 = __gamedata_start + 0x7E7D4);
PROVIDE(g_cameraState = __gamedata_start + 0x81600);
PROVIDE(g_cameraPos = __gamedata_start + 0x81740);
PROVIDE(g_cameraRot = __gamedata_start + 0x81750);
PROVIDE(g_cameraShakeUp = __gamedata_start + 0x81760);
PROVIDE(g_cameraShakeRight = __gamedata_start + 0x81770);
PROVIDE(g_cameraShakeRoll = __gamedata_start + 0x81780);
PROVIDE(g_activeCamera = __gamedata_start + 0x81790);
PROVIDE(g_cameraTriggerLatch = __gamedata_start + 0x81860);
PROVIDE(g_cameraHelperMoby = __gamedata_start + 0x81864);
PROVIDE(g_cameraTransitionState = __gamedata_start + 0x81890);
PROVIDE(g_cameraMatrix = __gamedata_start + 0x81970);
PROVIDE(g_bCameraUnderwater = __gamedata_start + 0x81A00);
PROVIDE(g_pLensFlareSource = __gamedata_start + 0x81A40);
PROVIDE(g_cameraSlots = __gamedata_start + 0x81B50);
PROVIDE(g_cameraSnapshot = __gamedata_start + 0x83950);
PROVIDE(g_cameraSnapshotPtr = __gamedata_start + 0x839C0);
PROVIDE(g_screenSpriteFxQueue = __gamedata_start + 0x83A00);
PROVIDE(g_cameraHistory = __gamedata_start + 0x83B30);
PROVIDE(g_cameraHistorySnapshot = __gamedata_start + 0x84030);
PROVIDE(g_cameraSlotActive = __gamedata_start + 0x842B0);
PROVIDE(g_sceneFrame = __gamedata_start + 0x84C74);
PROVIDE(g_nSceneSubChunkFrame = __gamedata_start + 0x84C78);
PROVIDE(g_nSceneTotalFrames = __gamedata_start + 0x84C80);
PROVIDE(g_nSceneCastCount = __gamedata_start + 0x84C84);
PROVIDE(DAT_001b8808 = __gamedata_start + 0x84C88);
PROVIDE(g_sceneVoiceEndFrame = __gamedata_start + 0x84C88);
PROVIDE(DAT_001b880c = __gamedata_start + 0x84C8C);
PROVIDE(g_sceneFmvStreamBase = __gamedata_start + 0x84C8C);
PROVIDE(g_sceneSubtitleList = __gamedata_start + 0x84C8C);
PROVIDE(g_pScenePlayerMoby = __gamedata_start + 0x84C94);
PROVIDE(g_pSceneCameraKeys = __gamedata_start + 0x84CA8);
PROVIDE(g_pSceneData = __gamedata_start + 0x84CAC);
PROVIDE(g_pSceneLoadBuffer = __gamedata_start + 0x84CB0);
PROVIDE(g_pSceneCastMobys = __gamedata_start + 0x84DCC);
PROVIDE(g_sceneActorMobys = __gamedata_start + 0x84DCC);
PROVIDE(D_1B8FC0 = __gamedata_start + 0x85440);
PROVIDE(g_cameraProjScale = __gamedata_start + 0x854F0);
PROVIDE(g_fogColorRed = __gamedata_start + 0x85670);
PROVIDE(g_texUploadQueue = __gamedata_start + 0x85740);
PROVIDE(g_uiTextureCache = __gamedata_start + 0x85B40);
PROVIDE(g_fxHooksPreFuncs = __gamedata_start + 0x86240);
PROVIDE(g_fxHooksPreArgs = __gamedata_start + 0x86340);
PROVIDE(g_fxHooksPostFuncs = __gamedata_start + 0x86440);
PROVIDE(g_fxHooksPostArgs = __gamedata_start + 0x86540);
PROVIDE(g_drawHooksAfterTiesFuncs = __gamedata_start + 0x86640);
PROVIDE(g_drawHooksAfterTiesArgs = __gamedata_start + 0x86740);
PROVIDE(g_drawHooksAfterShrubsFuncs = __gamedata_start + 0x86840);
PROVIDE(g_drawHooksAfterShrubsArgs = __gamedata_start + 0x86940);
PROVIDE(g_blobShadowQueue = __gamedata_start + 0x86A40);
PROVIDE(D_001BAC00 = __gamedata_start + 0x87080);
PROVIDE(D_001BAC94 = __gamedata_start + 0x87114);
PROVIDE(g_cinematicQueue = __gamedata_start + 0x87140);
PROVIDE(g_occlusionVisMask = __gamedata_start + 0x871C0);
PROVIDE(g_memoryArenaTable = __gamedata_start + 0x872C0);
PROVIDE(g_sceneDecompressBase = __gamedata_start + 0x872CC);
PROVIDE(g_sceneArenaBase = __gamedata_start + 0x872D0);
PROVIDE(g_splashImageBuffer = __gamedata_start + 0x872D4);
PROVIDE(g_stagedSegmentCeiling = __gamedata_start + 0x8732C);
PROVIDE(g_shipModelBufferBase = __gamedata_start + 0x87330);
PROVIDE(g_heldItemModelBufferBase = __gamedata_start + 0x87334);
PROVIDE(g_playerModelBufferBase = __gamedata_start + 0x87338);
PROVIDE(g_debugMallocPoolBase = __gamedata_start + 0x8733C);
PROVIDE(g_pCollWorldData = __gamedata_start + 0x87380);
PROVIDE(g_pCollHitMoby = __gamedata_start + 0x87398);
PROVIDE(g_collHitPoint = __gamedata_start + 0x873A0);
PROVIDE(g_collHitPointNudged = __gamedata_start + 0x873B0);
PROVIDE(g_collHitNormal = __gamedata_start + 0x873C0);
PROVIDE(g_collHitTriVert2 = __gamedata_start + 0x873F0);
PROVIDE(g_collHitEventRing = __gamedata_start + 0x8B600);
PROVIDE(g_collTriBuffer = __gamedata_start + 0x8C600);
PROVIDE(g_dirLightMatrices = __gamedata_start + 0x8EB40);
PROVIDE(g_pointLights = __gamedata_start + 0x8EF40);
PROVIDE(g_modelTexRegs = __gamedata_start + 0x911C0);
PROVIDE(D_001C4EC0 = __gamedata_start + 0x91340);
PROVIDE(D_1C4EC0 = __gamedata_start + 0x91340);
PROVIDE(g_mapCache = __gamedata_start + 0x913A0);  /* same object as g_mapVertexData */
PROVIDE(g_mapVertexData = __gamedata_start + 0x913A0);
PROVIDE(g_mapBitmapBuffer = __gamedata_start + 0x913A8);
PROVIDE(g_pMapBitmapBuffer = __gamedata_start + 0x913A8);
PROVIDE(D_001C4F30 = __gamedata_start + 0x913B0);
PROVIDE(D_1C4F38 = __gamedata_start + 0x913B8);
PROVIDE(g_pMapBlipList = __gamedata_start + 0x913C0);
PROVIDE(g_mapHasData = __gamedata_start + 0x913C8);
PROVIDE(D_1C4F4C = __gamedata_start + 0x913CC);
PROVIDE(D_1C4F50 = __gamedata_start + 0x913D0);
PROVIDE(D_1C4FD4 = __gamedata_start + 0x91454);
PROVIDE(D_1C5028 = __gamedata_start + 0x914A8);
PROVIDE(D_1C507C = __gamedata_start + 0x914FC);
PROVIDE(g_mapCurrentLevel = __gamedata_start + 0x915D0);
PROVIDE(g_nMapCurrentLevel = __gamedata_start + 0x915D0);
PROVIDE(g_mapActiveSlot = __gamedata_start + 0x915D4);
PROVIDE(g_nMapActiveSlot = __gamedata_start + 0x915D4);
PROVIDE(g_mapTextureWidth = __gamedata_start + 0x915E0);
PROVIDE(D_1C516C = __gamedata_start + 0x915EC);
PROVIDE(D_001C5188 = __gamedata_start + 0x91608);
PROVIDE(D_001C5198 = __gamedata_start + 0x91618);
PROVIDE(g_proceduralAnimFrames = __gamedata_start + 0x91940);
PROVIDE(g_proceduralAnimBounds = __gamedata_start + 0x99940);
PROVIDE(g_mobyClassHeaders = __gamedata_start + 0x99F80);
PROVIDE(g_mobyClassUpdateFuncs = __gamedata_start + 0x9A340);
PROVIDE(g_mobyClassSlotToId = __gamedata_start + 0x9A700);
PROVIDE(g_mobyClassSlotRemap = __gamedata_start + 0x9A8E0);
PROVIDE(g_mobyClassUpdateFuncsNoHeader = __gamedata_start + 0x9C8E0);
PROVIDE(g_mobyTexVramTable = __gamedata_start + 0x9CE00);
PROVIDE(g_mobyClassDataSizes = __gamedata_start + 0x9D200);
PROVIDE(g_mobyClassBounds = __gamedata_start + 0x9D980);
PROVIDE(g_mobyGridBlockBitmap = __gamedata_start + 0xBA8E0);
PROVIDE(g_mobyGroupLists = __gamedata_start + 0xBA9A0);
PROVIDE(g_mobyFlagged1000List = __gamedata_start + 0xBAD60);
PROVIDE(g_mobyGlowWorkBuf = __gamedata_start + 0xBB6E0);
PROVIDE(D_001F0000 = __gamedata_start + 0xBC480);
PROVIDE(g_particleTexTable = __gamedata_start + 0xBE340);
PROVIDE(g_particleEffectDefs = __gamedata_start + 0xBE940);
PROVIDE(g_particleFxBlob = __gamedata_start + 0xBEB40);
PROVIDE(D_1F27C0 = __gamedata_start + 0xBEC40);
PROVIDE(g_menuScreenBlock = __gamedata_start + 0xBEC40);
PROVIDE(g_lastMenuScreenId = __gamedata_start + 0xBEC48);
PROVIDE(g_pCurrentMenuScreen = __gamedata_start + 0xBEC54);
PROVIDE(g_pNextMenuScreen = __gamedata_start + 0xBEC58);
PROVIDE(g_menuTransitionMode = __gamedata_start + 0xBEC5C);
PROVIDE(D_001F289B = __gamedata_start + 0xBED1B);
PROVIDE(D_001F28A4 = __gamedata_start + 0xBED24);
PROVIDE(g_pTextTableLoadBuf = __gamedata_start + 0xBED58);
PROVIDE(D_001F28DC = __gamedata_start + 0xBED5C);
PROVIDE(D_001F28F4 = __gamedata_start + 0xBED74);
PROVIDE(D_001F28F8 = __gamedata_start + 0xBED78);
PROVIDE(D_001F28FC = __gamedata_start + 0xBED7C);
PROVIDE(D_001F2924 = __gamedata_start + 0xBEDA4);
PROVIDE(g_nLevelSelectListCount = __gamedata_start + 0xDCE70);
PROVIDE(g_pLevelSelectListEntries = __gamedata_start + 0xDCE78);
PROVIDE(g_levelSelectListItems = __gamedata_start + 0xDCF20);
PROVIDE(g_shrubClassTable = __gamedata_start + 0xDEA50);
PROVIDE(g_shrubTexVramTable = __gamedata_start + 0xDFF50);
PROVIDE(g_shrubVisibleClassList = __gamedata_start + 0xE0450);
PROVIDE(g_shrubRelightList = __gamedata_start + 0xE0550);
PROVIDE(g_tfragTexVramTable = __gamedata_start + 0xE1B80);
PROVIDE(g_tfragTexPatchList = __gamedata_start + 0xE1E80);
PROVIDE(g_tfragRelightList = __gamedata_start + 0xE2280);
PROVIDE(g_tieClassQueue = __gamedata_start + 0xE2680);
PROVIDE(g_tieTexVramTable = __gamedata_start + 0xE9480);
PROVIDE(g_tieVisibleClassList = __gamedata_start + 0xE9A80);
PROVIDE(g_vendorUi = __gamedata_start + 0xEB640);
PROVIDE(g_vendorItemList = __gamedata_start + 0xEB780);
PROVIDE(g_nVendorItemCount = __gamedata_start + 0xEBD80);
PROVIDE(D_00220000 = __gamedata_start + 0xEC480);
PROVIDE(D_238E80 = __gamedata_start + 0x105300);
PROVIDE(D_239A90 = __gamedata_start + 0x105F10);
PROVIDE(g_weaponTable = __gamedata_start + 0x105FA0);
PROVIDE(g_weaponSlotTable = __gamedata_start + 0x105FAC);
PROVIDE(g_weaponClassTable = __gamedata_start + 0x105FB4);
PROVIDE(D_00239B8C = __gamedata_start + 0x10600C);
PROVIDE(D_240340 = __gamedata_start + 0x10C7C0);
PROVIDE(D_2403D0 = __gamedata_start + 0x10C850);
PROVIDE(g_subtitleState = __gamedata_start + 0x121278);
PROVIDE(g_nActiveTextTableCount = __gamedata_start + 0x1212A4);
PROVIDE(D_254E48 = __gamedata_start + 0x1212C8);
PROVIDE(D_002550F0 = __gamedata_start + 0x121570);
PROVIDE(D_2552B0 = __gamedata_start + 0x121730);
PROVIDE(D_255A00 = __gamedata_start + 0x121E80);
PROVIDE(D_255A60 = __gamedata_start + 0x121EE0);
PROVIDE(g_skyShellSpinTableStatic = __gamedata_start + 0x121F40);
PROVIDE(g_skyShellSpinTableScaled = __gamedata_start + 0x121FB8);
PROVIDE(D_255E50 = __gamedata_start + 0x1222D0);
PROVIDE(D_256050 = __gamedata_start + 0x1224D0);
PROVIDE(g_saveSectionTableGlobal = __gamedata_start + 0x122538);
PROVIDE(g_saveSectionTableArea = __gamedata_start + 0x122768);
PROVIDE(D_256398 = __gamedata_start + 0x122818);
PROVIDE(g_menuButtons = __gamedata_start + 0x122818);
PROVIDE(D_257502 = __gamedata_start + 0x123982);
PROVIDE(D_2579B2 = __gamedata_start + 0x123E32);
PROVIDE(D_258B20 = __gamedata_start + 0x124FA0);
PROVIDE(g_levelObjectiveLists = __gamedata_start + 0x124FA0);
PROVIDE(D_258C00 = __gamedata_start + 0x125080);
PROVIDE(D_258C50 = __gamedata_start + 0x1250D0);
PROVIDE(D_258CA0 = __gamedata_start + 0x125120);
PROVIDE(D_258CF0 = __gamedata_start + 0x125170);
PROVIDE(g_levelSelectEntries = __gamedata_start + 0x1251D0);
PROVIDE(g_MenuScreen_LevelSelectList = __gamedata_start + 0x125478);
PROVIDE(D_00259128 = __gamedata_start + 0x1255A8);
PROVIDE(D_00259178 = __gamedata_start + 0x1255F8);
PROVIDE(D_002591C8 = __gamedata_start + 0x125648);
PROVIDE(D_00259218 = __gamedata_start + 0x125698);
PROVIDE(D_00259268 = __gamedata_start + 0x1256E8);
PROVIDE(D_002592B8 = __gamedata_start + 0x125738);
PROVIDE(D_00259308 = __gamedata_start + 0x125788);
PROVIDE(D_00259438 = __gamedata_start + 0x1258B8);
PROVIDE(D_002598F8 = __gamedata_start + 0x125D78);
PROVIDE(D_00259A88 = __gamedata_start + 0x125F08);
PROVIDE(D_00259AD8 = __gamedata_start + 0x125F58);
PROVIDE(D_00259B28 = __gamedata_start + 0x125FA8);
PROVIDE(D_259C24 = __gamedata_start + 0x1260A4);
PROVIDE(D_00259C58 = __gamedata_start + 0x1260D8);
PROVIDE(D_259CC0 = __gamedata_start + 0x126140);
PROVIDE(D_259E34 = __gamedata_start + 0x1262B4);
PROVIDE(D_00259E50 = __gamedata_start + 0x1262D0);
PROVIDE(D_00259F38 = __gamedata_start + 0x1263B8);
PROVIDE(D_259F38 = __gamedata_start + 0x1263B8);
PROVIDE(D_0025A038 = __gamedata_start + 0x1264B8);
PROVIDE(g_MenuScreen_GalacticMap = __gamedata_start + 0x1265F0);
PROVIDE(g_MenuScreen_MapBackTarget = __gamedata_start + 0x1268F8);
PROVIDE(D_0025A600 = __gamedata_start + 0x126A80);
PROVIDE(D_25A600 = __gamedata_start + 0x126A80);
PROVIDE(D_0025A6C0 = __gamedata_start + 0x126B40);
PROVIDE(D_0025A6F4 = __gamedata_start + 0x126B74);
PROVIDE(D_0025A6FC = __gamedata_start + 0x126B7C);
PROVIDE(g_MenuScreen_Id10 = __gamedata_start + 0x126B98);
PROVIDE(D_0025ABA0 = __gamedata_start + 0x127020);
PROVIDE(D_0025AC08 = __gamedata_start + 0x127088);
PROVIDE(D_0025AD90 = __gamedata_start + 0x127210);
PROVIDE(D_25AD90 = __gamedata_start + 0x127210);
PROVIDE(D_25B5D8 = __gamedata_start + 0x127A58);
PROVIDE(D_25B9A0 = __gamedata_start + 0x127E20);
PROVIDE(D_25BA60 = __gamedata_start + 0x127EE0);
PROVIDE(D_0025BA70 = __gamedata_start + 0x127EF0);
PROVIDE(D_25BA70 = __gamedata_start + 0x127EF0);
PROVIDE(D_25C004 = __gamedata_start + 0x128484);
PROVIDE(D_25C074 = __gamedata_start + 0x1284F4);
PROVIDE(D_0025C098 = __gamedata_start + 0x128518);
PROVIDE(D_25C1F0 = __gamedata_start + 0x128670);
PROVIDE(D_0025C230 = __gamedata_start + 0x1286B0);
PROVIDE(D_25C298 = __gamedata_start + 0x128718);
PROVIDE(D_25C388 = __gamedata_start + 0x128808);
PROVIDE(D_0025C3C8 = __gamedata_start + 0x128848);
PROVIDE(D_0025C430 = __gamedata_start + 0x1288B0);
PROVIDE(D_25C520 = __gamedata_start + 0x1289A0);
PROVIDE(D_0025C560 = __gamedata_start + 0x1289E0);
PROVIDE(D_0025C5C8 = __gamedata_start + 0x128A48);
PROVIDE(D_25C6B8 = __gamedata_start + 0x128B38);
PROVIDE(D_0025C6F8 = __gamedata_start + 0x128B78);
PROVIDE(D_25C760 = __gamedata_start + 0x128BE0);
PROVIDE(D_25C8C4 = __gamedata_start + 0x128D44);
PROVIDE(D_25C940 = __gamedata_start + 0x128DC0);
PROVIDE(D_25C950 = __gamedata_start + 0x128DD0);
PROVIDE(D_0025CA80 = __gamedata_start + 0x128F00);
PROVIDE(D_25CA80 = __gamedata_start + 0x128F00);
PROVIDE(D_25CABC = __gamedata_start + 0x128F3C);
PROVIDE(D_25CB30 = __gamedata_start + 0x128FB0);
PROVIDE(D_25CB40 = __gamedata_start + 0x128FC0);
PROVIDE(D_25CCC8 = __gamedata_start + 0x129148);
PROVIDE(D_0025CCD8 = __gamedata_start + 0x129158);
PROVIDE(D_0025D0C0 = __gamedata_start + 0x129540);
PROVIDE(D_25D0C0 = __gamedata_start + 0x129540);
PROVIDE(D_0025D268 = __gamedata_start + 0x1296E8);
PROVIDE(D_25D268 = __gamedata_start + 0x1296E8);
PROVIDE(D_0025D458 = __gamedata_start + 0x1298D8);
PROVIDE(D_0025DB48 = __gamedata_start + 0x129FC8);
PROVIDE(g_menuBgImageIndex = __gamedata_start + 0x12A510);
PROVIDE(D_25E264 = __gamedata_start + 0x12A6E4);
PROVIDE(D_0025E298 = __gamedata_start + 0x12A718);
PROVIDE(D_25E308 = __gamedata_start + 0x12A788);
PROVIDE(D_25E444 = __gamedata_start + 0x12A8C4);
PROVIDE(D_25E660 = __gamedata_start + 0x12AAE0);
PROVIDE(D_0025EBB0 = __gamedata_start + 0x12B030);
PROVIDE(D_0025EBEE = __gamedata_start + 0x12B06E);
PROVIDE(D_0025EBFA = __gamedata_start + 0x12B07A);
PROVIDE(D_0025EC06 = __gamedata_start + 0x12B086);
PROVIDE(D_0025EC10 = __gamedata_start + 0x12B090);
PROVIDE(D_0025EC12 = __gamedata_start + 0x12B092);
PROVIDE(D_0025FC70 = __gamedata_start + 0x12C0F0);
PROVIDE(D_260570 = __gamedata_start + 0x12C9F0);
PROVIDE(D_00260D98 = __gamedata_start + 0x12D218);
PROVIDE(D_2614C8 = __gamedata_start + 0x12D948);
PROVIDE(D_2615D8 = __gamedata_start + 0x12DA58);
PROVIDE(D_261678 = __gamedata_start + 0x12DAF8);
PROVIDE(D_261730 = __gamedata_start + 0x12DBB0);
PROVIDE(D_2617C0 = __gamedata_start + 0x12DC40);
PROVIDE(g_cinematicsMenuTable = __gamedata_start + 0x12DCB8);
PROVIDE(D_26183A = __gamedata_start + 0x12DCBA);
PROVIDE(D_00261900 = __gamedata_start + 0x12DD80);
PROVIDE(D_261900 = __gamedata_start + 0x12DD80);
PROVIDE(D_00261978 = __gamedata_start + 0x12DDF8);
PROVIDE(D_00261BE8 = __gamedata_start + 0x12E068);
PROVIDE(D_261BE8 = __gamedata_start + 0x12E068);
PROVIDE(g_cheatCodeSymbols = __gamedata_start + 0x12E068);
PROVIDE(D_261CF0 = __gamedata_start + 0x12E170);
PROVIDE(g_skyShellAngles = __gamedata_start + 0x12E230);
PROVIDE(D_262920 = __gamedata_start + 0x12EDA0);
PROVIDE(D_00262BA0 = __gamedata_start + 0x12F020);
PROVIDE(D_262BA0 = __gamedata_start + 0x12F020);
PROVIDE(D_262D30 = __gamedata_start + 0x12F1B0);
PROVIDE(D_262D98 = __gamedata_start + 0x12F218);
PROVIDE(D_262E00 = __gamedata_start + 0x12F280);
PROVIDE(D_263B10 = __gamedata_start + 0x12FF90);
PROVIDE(g_debugFontGlyphTable = __gamedata_start + 0x130330);
PROVIDE(D_264250 = __gamedata_start + 0x1306D0);
PROVIDE(g_bestiaryEntryTable = __gamedata_start + 0x130A70);
PROVIDE(D_264DD0 = __gamedata_start + 0x131250);
PROVIDE(D_264E40 = __gamedata_start + 0x1312C0);
PROVIDE(D_265100 = __gamedata_start + 0x131580);
PROVIDE(D_265250 = __gamedata_start + 0x1316D0);
PROVIDE(D_2652B0 = __gamedata_start + 0x131730);
PROVIDE(D_26CB10 = __gamedata_start + 0x138F90);
PROVIDE(g_skillPointMetaTable = __gamedata_start + 0x139398);
PROVIDE(D_26CFD0 = __gamedata_start + 0x139450);
PROVIDE(D_26CFD8 = __gamedata_start + 0x139458);
PROVIDE(D_26D528 = __gamedata_start + 0x1399A8);
PROVIDE(g_shipOptionNameTextId = __gamedata_start + 0x1399A8);
PROVIDE(D_26D5B8 = __gamedata_start + 0x139A38);
PROVIDE(D_26D648 = __gamedata_start + 0x139AC8);
PROVIDE(g_shipOptionFieldMask = __gamedata_start + 0x139AC8);
PROVIDE(D_26D6D8 = __gamedata_start + 0x139B58);
PROVIDE(g_shipOptionFieldValue = __gamedata_start + 0x139B58);
PROVIDE(D_26D768 = __gamedata_start + 0x139BE8);
PROVIDE(D_26D7F8 = __gamedata_start + 0x139C78);
PROVIDE(g_shipOptionSkillPointsRequired = __gamedata_start + 0x139C78);
PROVIDE(D_26D890 = __gamedata_start + 0x139D10);
PROVIDE(g_builtinMobyUpdateBindings = __gamedata_start + 0x13AD00);
PROVIDE(g_cameraModeVtbl = __gamedata_start + 0x13AD80);
